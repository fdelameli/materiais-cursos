;*	*	*	*	*	*	*	*	*	*
;*			  Programação em Assembly			*
;* 	                  EXEMPLO6: Calculadora 			*
;*		     APOSTILA MÓDULO B  -  PIC16F877A			*
;*		      CERNE TECNOLOGIA E TREINAMENTO			*
;*	    VERSÃO 1.0				DATA:03/05/2005		*
;*									*
;*	*	*	*	*	*	*	*	*	*

;*	*	*	*	*	*	*	*	*	*
;*			 OBJETIVO DO ARQUIVO FONTE			*
;*									*
;*    NESTE PROJETO, IREMOS RECEBER 2 BYTES DA PORTA SERIAL E IREMOS 	*
;* APLICAR AS 4 OPERAÇÕES ARITMÉTICAS BÁSICAS E RETORNAREMOS O RESULTADO*
;*	 PARA O PC ASSIM COMO IREMOS MOSTRAR O MESMO NO DISPLAY.	*
;*									*
;*	*	*	*	*	*	*	*	*	*

 #INCLUDE <P16F877.INC> 	;ARQUIVO PADRÃO PARA PIC16F877A
 __CONFIG _CP_OFF & _XT_OSC & _PWRTE_ON & _LVP_OFF & _WDT_ON & _BODEN_OFF & _CPD_OFF & _DEBUG_OFF
 	
 	;NESTE PONTO É INFORMADO A CONFIGURAÇÃO DA MÁQUINA, OU SEJA, SE TERÁ
 	;CÓDIGO DE PROTEÇÃO OU O TIPO DE CRISTAL QUE SERÁ UTILIZADO	

 	;CONFIGURAÇÃO DA MÁQUINA
 	; CODE PROTECT		        -> DESLIGADO
 	; OSCILADOR    		        -> CRISTAL OU RESSONADOR
 	; POWER-UP     		        -> LIGADO
 	; DEBUF 		        -> DESLIGADO		
 	; PROGRAMAÇÃO EM BAIXA VOLTAGEM -> DESLIGADO
	; WATCH DOG			-> LIGADO
	; BROWN-OUT RESET		-> DESLIGADO
	; PROTEÇÃO DE EEPROM		-> DESLIGADO
	 	
;*	*	*	*	*	*	*	*	*	*
;*			   PAGINAÇÃO DE MEMÓRIA				*
;*	*	*	*	*	*	*	*	*	*

; AQUI CRIAREMOS UM PSEUDÔNIMO PARA UM COMANDO. POR EXEMPLO, O COMANDO
; "BCF STATUS,RP0" PODE SER SUBSTITUÍDO SEM PROBLEMAS POR "BANK0". O 
; COMPILADOR IRÁ SUBSTITUIR INTERNAMENTE "BANK0" POR "BCF STATUS,RP0".
; ESTA APLICAÇÃO É VÁLIDA PARA OUTROS TIPOS DE COMANDOS

#DEFINE	BANK0	BCF	STATUS,RP0	; ESCOLHE BANCO DE MEMÓRIA 0
#DEFINE	BANK1	BSF	STATUS,RP0	; ESCOLHE BANCO DE MEMÓRIA 1

;*	*	*	*	*	*	*	*	*	*
;*			     DEFINICAO DE RAM				*
;*	*	*	*	*	*	*	*	*	*

; AQUI IREMOS CRIAR AS VARIÁVEIS DO NOSSO SISTEMA

	CBLOCK 0x20	 ; INÍCIO DO BLOCO DE RAM(GPR)
		TEMPO1   ; VARIÁVEL DA ROTINA DE TEMPO		
		TEMPO2   ; VARIÁVEL DA ROTINA DE TEMPO				
		TEMP	 ; VARIÁVEL TEMPORÁRIA		
		FLAGS	 ; VARIÁVEL PARA DECLARAÇÃO DE FLAGS
		ARG0  	 ; PARÂMETRO DE ENTRADA PARA ROTINA 
		ARG1	 ; DE MULTIPLICAÇÃO E DIVISÃO
		ARG2	 ;	
		MUL1	 ; VARIÁVEIS TEMPORÁRIAS PARA AS 	  
		MUL0	 ; ROTINAS DE MULTIPLICAÇÃO E DIVISÃO
		PARAMETRO_1 ; PARÂMETROS ORIUNDOS DA SERIAL 1
		PARAMETRO_2 ; PARÂMETROS ORIUNDOS DA SERIAL 2
		CONVERSAO_4 ; RESULTADO DA CONVERSÃO BIN->DEC
		CONVERSAO_3 ; RESULTADO DA CONVERSÃO BIN->DEC
		CONVERSAO_2 ; RESULTADO DA CONVERSÃO BIN->DEC
		CONVERSAO_1 ; RESULTADO DA CONVERSÃO BIN->DEC
		CONVERSAO_0 ; RESULTADO DA CONVERSÃO BIN->DEC	
		MSB	    ; PARÂMETROS DE ENTRADA	
		LSB	    ; DA ROTINA DE CONVERSÃO BIN->DEC	
	ENDC		 ; FIM DO BLOCO DE RAM(GPR)
	
	CBLOCK 0x70
		W_TEMP	 ; VARIÁVEIS TEMPORÁRIAS
		STATUS_TEMP	
		FSR_TEMP
		PCLATH_TEMP
	ENDC
		
;*	*	*	*	*	*	*	*	*	*
;*		          DEFINICAO DE FLAGS				*
;*	*	*	*	*	*	*	*	*	*

; AQUI SÃO DEFINIDOS OS FLAGS QUE SERÃO UTILIZADOS PELO SISTEMA

#DEFINE PODE_CONVERTER	FLAGS,0		; FLAG INDICADOR PARA INÍCIO 	
					; DA APLICAÇÃO DAS OPERAÇÕES
					
;*	*	*	*	*	*	*	*	*	*
;*		        DEFINICAO DE CONSTANTES				*
;*	*	*	*	*	*	*	*	*	*

; AQUI SÃO DEFINIDOS AS CONSTANTES QUE SERÃO UTILIZADOS PELO SISTEMA

#DEFINE LINHA_SUP	0x80	; CONSTANTE PARA LINHA SUPERIOR
#DEFINE LINHA_INF	0xC0	; CONSTANTE PARA LINHA INFERIOR
#DEFINE	TEMPO_BEEP	.10	; CONSTANTE PARA TOCAR BEEP(MULTIPLOS DE 1ms) 

;*	*	*	*	*	*	*	*	*	*
;*			  ENTRADAS DO SISTEMA				*
;*	*	*	*	*	*	*	*	*	*

#DEFINE COL1		PORTA,4	     ; PINO DE ENTRADA DA COLUNA1	
#DEFINE COL2		PORTA,5	     ; PINO DE ENTRADA DA COLUNA2		
#DEFINE COL3		PORTE,0	     ; PINO DE ENTRADA DA COLUNA3		

;*	*	*	*	*	*	*	*	*	*
;*			  SAÍDAS DO SISTEMA				*
;*	*	*	*	*	*	*	*	*	*

; AQUI SÃO DEFINIDAS AS SAÍDAS QUE SERÃO UTILIZADOS PELO SISTEMA

#DEFINE BUS		PORTD	; DEFINE O BARRAMENTO COMO O PORTD 
#DEFINE RS		PORTE,1	; RS DO DISPLAY
#DEFINE EN		PORTE,2 ; EN DO DISPLAY
#DEFINE BEEP		PORTC,5	; SAÍDA PARA LIGAR O BEEP

;*	*	*	*	*	*	*	*	*	*
;*			    VETOR DE RESET				*
;*	*	*	*	*	*	*	*	*	*

	ORG 	0x0000		; ENDEREÇO INICIAL DA MÁQUINA
	GOTO	CONFIG_		; SALTA PARA CONFIGURAR A MÁQUINA

;*	*	*	*	*	*	*	*	*	*
;*		         VETOR DE INTERRUPÇÃO				*
;*	*	*	*	*	*	*	*	*	*

	ORG 	0x0004		; ENDEREÇO INICIAL DO VETOR DE INTERRUPÇÃO
SALVA_CONTEXTO
	MOVWF	W_TEMP		; SALVA W
	SWAPF	STATUS,W	
	MOVWF	STATUS_TEMP	; SALVA STATUS
	MOVF	FSR,W
	MOVWF	FSR_TEMP	; SALVA FSR	
	MOVF	PCLATH,W	
	MOVWF	PCLATH_TEMP	; SALVA PCLATH
	
	CLRF	STATUS		; GARANTE BANCO 0
	CLRF	PCLATH		; GARANTE PÁGINA 0
	
	BTFSC	PIR1,RCIF	; INTERRUPÇÃO SERIAL?
	GOTO	TRATA_SERIAL	; SIM, ENTÃO TRATA
	
SAI_INTERRUPCAO	
	MOVF	FSR_TEMP,W
	MOVWF	FSR		; RECUPERA FSR
	MOVF	PCLATH_TEMP,W	
	MOVWF	PCLATH		; RECUPERA PCLATH
	SWAPF	STATUS_TEMP,W
	MOVWF	STATUS		; RECUPERA STATUS
	SWAPF	W_TEMP,F
	SWAPF	W_TEMP,W	; RECUPERA W
	RETFIE			; RETORNA DA INTERRUPÇÃO

;*	*	*	*	*	*	*	*	*	*
;*     	            TRATATAMENTO DE INTERRUPÇÃO DE TIMER0		*
;*	*	*	*	*	*	*	*	*	*

TRATA_SERIAL
	
	MOVF	RCREG,W		; CARREGA DADO RECEBIDO EM 
	MOVWF	PARAMETRO_1	; PARAMETRO_1
	
	BTFSS	PIR1,RCIF	; AGUARDA RECEBER O PRÓXIMO BYTE
	GOTO	$-1
	
	MOVF	RCREG,W		; CARREGA DADO RECEBIDO EM
	MOVWF	PARAMETRO_2	; PARAMETRO_2
	
	BSF	PODE_CONVERTER	; SETA FLAG PARA TRATAR OS DADOS RECEBIDOS
	
	GOTO	SAI_INTERRUPCAO	; SAI DA INTERRUPÇÃO

;*	*	*	*	*	*	*	*	*	*
;*	              ROTINA DE DELAY DE 1ms A 256ms			*
;*	*	*	*	*	*	*	*	*	*

	
DELAY_MS
	
	CLRWDT
	
	MOVWF	TEMPO2		; SALVA O VALOR MULTIPLICADOR
	CLRF	TEMPO1		; LIMPA REGISTRADOR

DELAY_A
	
	NOP			; PERDE 1 CICLO DE MÁQUINA
	DECFSZ	TEMPO1,F	; DECREMENTA REGISTRADOR, ACABOU?
	GOTO	$-2		; NÃO, ENTÃO RETORNA DUAS POSIÇÕES 
	DECFSZ	TEMPO2,F
	GOTO	DELAY_A
	
	RETURN			; RETORNA DA INTERRUPÇÃO

;*	*	*	*	*	*	*	*	*	*
;*	          ROTINA PARA ESCREVER DADOS NO DISPLAY			*
;*	*	*	*	*	*	*	*	*	*

ENVIA_COMANDO
	
	BCF	RS		; PÕE EM MODO DE COMANDO
	
ENVIA_DADO
	
	MOVWF	BUS		; MOVE DADO PARA O PORTD
		
	GOTO	$+1		; DEÇAY PARA ACOMODAÇÃO
	GOTO	$+1		
	
	BSF	EN		; GERA PULSO DE CLOCK
	GOTO	$+1
	BCF	EN
	
	BSF	RS		; VOLTA PARA O MODO DADOS
	MOVLW	.1
	CALL	DELAY_MS
	RETURN			; RETORNA DA INTERRUPÇÃO

;*	*	*	*	*	*	*	*	*	*
;*	  	    ROTINA PARA ENVIAR 1 BYTE PELA SERIAL		*
;*	*	*	*	*	*	*	*	*	*

TRANSMITE
	
	MOVWF	TXREG		; MOVE DADO A TRANSMITIR PARA TXREG
	BANK1
	BTFSS	TXSTA,TRMT	; AGUARDA O FIM DA TRANSMISSÃO
	GOTO	$-1
	BANK0
	RETURN			; RETORNA DA SUB-ROTINA

;*	*	*	*	*	*	*	*	*	*
;*	          ROTINA DE CONVERSÃO BINÁRIO PARA DECIMAL 		*
;*		             ENTRADAS: MSB:LSB				*
;*  SAÍDA: CONVERSAO_4:CONVERSAO_3:CONVERSAO_2:CONVERSAO_1:CONVERSAO_0  *
;*	*	*	*	*	*	*	*	*	*

BIN_TO_DEC
	
	CLRF	CONVERSAO_0	; INICIALIZA VARIÁVEIS DE CONVERSÃO
	CLRF	CONVERSAO_1
	CLRF	CONVERSAO_2
	CLRF	CONVERSAO_3
	CLRF	CONVERSAO_4
		
	MOVF	LSB,F		; VERIFICA SE ALGUMA DAS VARIÁVEIS É NULA
	BTFSS	STATUS,Z
	GOTO	INC_MSB
	
	MOVF	MSB,F
	BTFSC	STATUS,Z
	RETURN
	
	MOVF	LSB,F
	BTFSC	STATUS,Z
	GOTO	CONVERSAO_A
	
INC_MSB	

	INCF	MSB,F
		
CONVERSAO_A

	CLRWDT	
	INCF	CONVERSAO_0,F		; FAZ A CONVERSÃO DO
	MOVLW	.10			; RESULTADO PASSADO COMO ARGUMENTO
	XORWF	CONVERSAO_0,W
	BTFSS	STATUS,Z
	GOTO	CONVERSAO_B
	
	CLRF	CONVERSAO_0
	INCF	CONVERSAO_1,F
	MOVLW	.10
	XORWF	CONVERSAO_1,W
	BTFSS	STATUS,Z
	GOTO	CONVERSAO_B
	
	CLRF	CONVERSAO_1
	INCF	CONVERSAO_2,F
	MOVLW	.10
	XORWF	CONVERSAO_2,W
	BTFSS	STATUS,Z
	GOTO	CONVERSAO_B
	
	CLRF	CONVERSAO_2
	INCF	CONVERSAO_3,F
	MOVLW	.10
	XORWF	CONVERSAO_3,W
	BTFSS	STATUS,Z
	GOTO	CONVERSAO_B
	
	CLRF	CONVERSAO_3
	INCF	CONVERSAO_4,F
	
CONVERSAO_B	

	DECFSZ	LSB,F
	GOTO	CONVERSAO_A
	
	DECFSZ	MSB,F
	GOTO	CONVERSAO_A
		
	RETURN	

;*	*	*	*	*	*	*	*	*	*
;*	              ROTINA DE MULTIPLICACÃO 8x8			*
;*			  ENTRADAS: ARG1:ARG0				*	
;*			   SAÍDA: ARG1:ARG0				*
;*		    VARIÁVEIS AUXILIARES: MUL1:MUL0			*
;*	*	*	*	*	*	*	*	*	*

MULTIPLICACAO

	MOVF	ARG0,F		; VERIFICA SE ALGUMA DAS VARIÁVEIS
	BTFSC	STATUS,Z	; É NULA	
	GOTO	SAI_EM_0
	
	MOVF	ARG1,F
	BTFSC	STATUS,Z
	GOTO	SAI_EM_0
	
	CLRF	MUL1
	CLRF	MUL0
	
MULT
	MOVF	ARG0,W		; FAZ A SOMA SUCESSIVA, OU SEJA
	ADDWF	MUL0,F		; A MULTIPLICAÇÃO
	BTFSC	STATUS,C
	INCF	MUL1,F
	
	DECFSZ	ARG1,F
	GOTO	MULT

SAI_COM_DADO
	
	MOVF	MUL1,W		; RETORNA O VALOR DA MULTIPLICAÇÃO
	MOVWF	ARG1
	MOVF	MUL0,W
	MOVWF	ARG0
	RETURN
		
SAI_EM_0
	
	CLRF	ARG0
	CLRF	ARG1
	RETURN	

;*	*	*	*	*	*	*	*	*	*
;*                      ROTINA DE DIVISÃO DE 16 BITS			*
;*		ENTRADAS: DIVIDENDO(ARG1:ARG0) DIVISOR(ARG2) 		*
;*			    SAÍDA: ARG1:ARG0				*
;*	       	     VARIÁVEIS AUXILIARES: MUL1:MUL0			*
;*	*	*	*	*	*	*	*	*	*

DIVIDE
	CLRF	MUL1		; INICIALIZA REGISTRADORES AUXILIARES
	CLRF	MUL0
	
	MOVF	ARG2,F		; VERIFICA SE O DIVISOR É IGUAL A 0
	BTFSC	STATUS,Z
	GOTO	SAI_EM_0	; CASO SEJA, RETORNA EM 0
	
	MOVF	ARG0,F		; VERIFICA SE O DIVIDENDO É ZERO
	BTFSS	STATUS,Z
	GOTO	DIVIDE_A
	
	MOVF	ARG1,F
	BTFSC	STATUS,Z
	GOTO	SAI_EM_0	; CASO SEJA, RETORNA EM 0
	
DIVIDE_A

	MOVF	ARG2,W		; FAZ A SUBTRAÇÃO SUCESSIVA, OU SEJA, 
	SUBWF	ARG0,F		; A DIVISÃO	
	BTFSS	STATUS,C
	GOTO	DIVIDE_B

DIVIDE_C

	INCF	MUL0,F
	BTFSC	STATUS,Z
	INCF	MUL1,F
	GOTO	DIVIDE_A

DIVIDE_B

	MOVF	ARG1,F
	BTFSC	STATUS,Z
	GOTO	SAI_COM_DADO	; RETORNA COMO O VALOR DA DIVISÃO
	DECF	ARG1,F
	GOTO	DIVIDE_C
	
;*	*	*	*	*	*	*	*	*	*
;*		     ROTINA PARA APRESENTAR A TELA INCIIAL 		*
;*	*	*	*	*	*	*	*	*	*

TELA_INICIAL
	
	MOVLW	0x80
	CALL	ENVIA_COMANDO	; COMANDO PARA POSICIONAR O DISPLAY
	
	MOVLW	'+'
	CALL	ENVIA_DADO	; ENVIA CARACTER ASCII	
	
	MOVLW	':'
	CALL	ENVIA_DADO	; ENVIA CARACTER ASCII	
	
	MOVLW	'0'
	CALL	ENVIA_DADO	; ENVIA CARACTER ASCII	
		
	MOVLW	'0'
	CALL	ENVIA_DADO	; ENVIA CARACTER ASCII	
	
	MOVLW	'0'
	CALL	ENVIA_DADO	; ENVIA CARACTER ASCII	
	
	MOVLW	'0'
	CALL	ENVIA_DADO	; ENVIA CARACTER ASCII	
	
	MOVLW	' '
	CALL	ENVIA_DADO	; ENVIA CARACTER ASCII	
	
	MOVLW	' '
	CALL	ENVIA_DADO	; ENVIA CARACTER ASCII	
	
	MOVLW	' '
	CALL	ENVIA_DADO	; ENVIA CARACTER ASCII	
	
	MOVLW	'-'
	CALL	ENVIA_DADO	; ENVIA CARACTER ASCII	
	
	MOVLW	':'
	CALL	ENVIA_DADO	; ENVIA CARACTER ASCII	
		
	MOVLW	'0'
	CALL	ENVIA_DADO	; ENVIA CARACTER ASCII	
	
	MOVLW	'0'
	CALL	ENVIA_DADO	; ENVIA CARACTER ASCII	
	 
	MOVLW	'0'
	CALL	ENVIA_DADO	; ENVIA CARACTER ASCII	
	 
	MOVLW	' '
	CALL	ENVIA_DADO	; ENVIA CARACTER ASCII	
	
	MOVLW	' '
	CALL	ENVIA_DADO	; ENVIA CARACTER ASCII	
	 
	MOVLW	0xC0
	CALL	ENVIA_COMANDO	; COMANDO PARA POSICIONAR O DISPLAY
	
	MOVLW	'*'
	CALL	ENVIA_DADO	; ENVIA CARACTER ASCII	
	
	MOVLW	':'
	CALL	ENVIA_DADO	; ENVIA CARACTER ASCII	
	
	MOVLW	'0'
	CALL	ENVIA_DADO	; ENVIA CARACTER ASCII	
		
	MOVLW	'0'
	CALL	ENVIA_DADO	; ENVIA CARACTER ASCII	
	
	MOVLW	'0'
	CALL	ENVIA_DADO	; ENVIA CARACTER ASCII	
	
	MOVLW	'0'
	CALL	ENVIA_DADO	; ENVIA CARACTER ASCII	
	
	MOVLW	'0'
	CALL	ENVIA_DADO	; ENVIA CARACTER ASCII	
	
	MOVLW	' '
	CALL	ENVIA_DADO	; ENVIA CARACTER ASCII	
	
	MOVLW	' '
	CALL	ENVIA_DADO	; ENVIA CARACTER ASCII	
	
	MOVLW	'/'
	CALL	ENVIA_DADO	; ENVIA CARACTER ASCII	
	
	MOVLW	':'
	CALL	ENVIA_DADO	; ENVIA CARACTER ASCII	
		
	MOVLW	'0'
	CALL	ENVIA_DADO	; ENVIA CARACTER ASCII	
	
	MOVLW	'0'
	CALL	ENVIA_DADO	; ENVIA CARACTER ASCII	
	 
	MOVLW	'0'
	CALL	ENVIA_DADO	; ENVIA CARACTER ASCII	
	 
	MOVLW	' '
	CALL	ENVIA_DADO	; ENVIA CARACTER ASCII	
	
	RETURN			; RETORNA DA ROTINA	

;*	*	*	*	*	*	*	*	*	*
;*		          	ROTINA DE SOMA				*
;*	*	*	*	*	*	*	*	*	*

SOM
	CLRF	LSB		; LIMPA LSB
	CLRF	MSB		; LIMPA MSB		
	
	MOVF	PARAMETRO_1,W	; FAZ A SOMA DOS PARÂMETROS
	MOVWF	LSB
	MOVF	PARAMETRO_2,W
	ADDWF	LSB,F
	BTFSC	STATUS,C
	INCF	MSB
	
	CALL	BIN_TO_DEC
	
	MOVLW	0x82
	CALL	ENVIA_COMANDO	; POSICIONA LCD
	
	MOVF	CONVERSAO_3,W	
	ADDLW	0x30		
	CALL	TRANSMITE	; CHAMA ROTINA PARA TRANSMITIR DADOS	
	CALL	ENVIA_DADO	; ENVIA CARACTER DA CONVERSÃO PARA LCD
	
	MOVF	CONVERSAO_2,W	
	ADDLW	0x30		
	CALL	TRANSMITE	; CHAMA ROTINA PARA TRANSMITIR DADOS	
	CALL	ENVIA_DADO	; ENVIA CARACTER DA CONVERSÃO PARA LCD
	
	MOVF	CONVERSAO_1,W	
	ADDLW	0x30		
	CALL	TRANSMITE	; CHAMA ROTINA PARA TRANSMITIR DADOS	
	CALL	ENVIA_DADO	; ENVIA CARACTER DA CONVERSÃO PARA LCD
	
	MOVF	CONVERSAO_0,W	
	ADDLW	0x30		
	CALL	TRANSMITE	; CHAMA ROTINA PARA TRANSMITIR DADOS	
	CALL	ENVIA_DADO	; ENVIA CARACTER DA CONVERSÃO PARA LCD
		
	RETURN

;*	*	*	*	*	*	*	*	*	*
;*		              ROTINA DE SUBTRAÇÃO			*
;*	*	*	*	*	*	*	*	*	*

SUB
	
	CLRF	MSB
	CLRF	LSB
	
	MOVF	PARAMETRO_2,W
	SUBWF	PARAMETRO_1,W
	BTFSC	STATUS,C
	MOVWF	LSB
	
	CALL	BIN_TO_DEC
	
	MOVLW	0x8B
	CALL	ENVIA_COMANDO	; POSICIONA LCD
	
	MOVF	CONVERSAO_2,W	
	ADDLW	0x30		
	CALL	TRANSMITE	; CHAMA ROTINA PARA TRANSMITIR DADOS	
	CALL	ENVIA_DADO	; ENVIA CARACTER DA CONVERSÃO PARA LCD
	
	MOVF	CONVERSAO_1,W	
	ADDLW	0x30		
	CALL	TRANSMITE	; CHAMA ROTINA PARA TRANSMITIR DADOS	
	CALL	ENVIA_DADO	; ENVIA CARACTER DA CONVERSÃO PARA LCD
	
	MOVF	CONVERSAO_0,W	
	ADDLW	0x30		
	CALL	TRANSMITE	; CHAMA ROTINA PARA TRANSMITIR DADOS	
	CALL	ENVIA_DADO	; ENVIA CARACTER DA CONVERSÃO PARA LCD
		
	RETURN

;*	*	*	*	*	*	*	*	*	*
;*		       	     ROTINA DE MULTIPLICAÇÃO			*
;*	*	*	*	*	*	*	*	*	*

MUL
	
	MOVF	PARAMETRO_1,W
	MOVWF	ARG0
	MOVF	PARAMETRO_2,W
	MOVWF	ARG1
	
	CALL	MULTIPLICACAO
	
	MOVF	ARG0,W
	MOVWF	LSB
	MOVF	ARG1,W
	MOVWF	MSB
	
	CALL	BIN_TO_DEC
	
	MOVLW	0xC2
	CALL	ENVIA_COMANDO	; POSICIONA LCD
	
	MOVF	CONVERSAO_4,W	
	ADDLW	0x30		
	CALL	TRANSMITE	; CHAMA ROTINA PARA TRANSMITIR DADOS	
	CALL	ENVIA_DADO	; ENVIA CARACTER DA CONVERSÃO PARA LCD
	
	MOVF	CONVERSAO_3,W	
	ADDLW	0x30		
	CALL	TRANSMITE	; CHAMA ROTINA PARA TRANSMITIR DADOS	
	CALL	ENVIA_DADO	; ENVIA CARACTER DA CONVERSÃO PARA LCD
	
	MOVF	CONVERSAO_2,W	
	ADDLW	0x30		
	CALL	TRANSMITE	; CHAMA ROTINA PARA TRANSMITIR DADOS	
	CALL	ENVIA_DADO	; ENVIA CARACTER DA CONVERSÃO PARA LCD
	
	MOVF	CONVERSAO_1,W	
	ADDLW	0x30		
	CALL	TRANSMITE	; CHAMA ROTINA PARA TRANSMITIR DADOS	
	CALL	ENVIA_DADO	; ENVIA CARACTER DA CONVERSÃO PARA LCD
	
	MOVF	CONVERSAO_0,W	
	ADDLW	0x30		
	CALL	TRANSMITE	; CHAMA ROTINA PARA TRANSMITIR DADOS	
	CALL	ENVIA_DADO	; ENVIA CARACTER DA CONVERSÃO PARA LCD
		
	RETURN
	
;*	*	*	*	*	*	*	*	*	*
;*		          	ROTINA DE DIVISÃO			*
;*	*	*	*	*	*	*	*	*	*

DIV
	
	MOVF	PARAMETRO_1,W
	MOVWF	ARG0
	CLRF	ARG1		
	MOVF	PARAMETRO_2,W
	MOVWF	ARG2
	
	CALL	DIVIDE
	
	MOVF	ARG0,W
	MOVWF	LSB
	CLRF	MSB
	
	CALL	BIN_TO_DEC
	
	MOVLW	0xCB
	CALL	ENVIA_COMANDO	; POSICIONA LCD
	
	MOVF	CONVERSAO_2,W	
	ADDLW	0x30		
	CALL	TRANSMITE	; CHAMA ROTINA PARA TRANSMITIR DADOS	
	CALL	ENVIA_DADO	; ENVIA CARACTER DA CONVERSÃO PARA LCD
	
	MOVF	CONVERSAO_1,W	
	ADDLW	0x30		
	CALL	TRANSMITE	; CHAMA ROTINA PARA TRANSMITIR DADOS	
	CALL	ENVIA_DADO	; ENVIA CARACTER DA CONVERSÃO PARA LCD
	
	MOVF	CONVERSAO_0,W	
	ADDLW	0x30		
	CALL	TRANSMITE	; CHAMA ROTINA PARA TRANSMITIR DADOS	
	CALL	ENVIA_DADO	; ENVIA CARACTER DA CONVERSÃO PARA LCD
		
	RETURN
	
		
;*	*	*	*	*	*	*	*	*	*
;*		          CONFIGURACOES INICIAIS			*
;*	*	*	*	*	*	*	*	*	*

CONFIG_

	CLRF	PORTA		; LIMPA O PORTA
	CLRF	PORTB		; LIMPA O PORTB
	CLRF	PORTC		; LIMPA O PORTC
	CLRF	PORTD		; LIMPA O PORTD
	CLRF	PORTE		; LIMPA O PORTE
	
	BANK1			; SELECIONA BANCO1 DE MEMÓRIA
	
	MOVLW	B'11111111'
	MOVWF	TRISA
	
	MOVLW	B'11000000'
	MOVWF	TRISB		; CONFIGURA I/O DO PORTB
	
	MOVLW	B'11011111'
	MOVWF	TRISC		; CONFIGURA I/O DO PORTB
	
	MOVLW	B'00000000'	; CONFIGURA TODOS OS PINOS DESTE
	MOVWF	TRISD		; PORTB COMO SAÍDA
	
	MOVLW	B'00000001'
	MOVWF	TRISE		; CONFIGURA I/O DO PORTE
	
	MOVLW	B'10001111'	; DESLIGA PULL-UPS
	MOVWF	OPTION_REG	; WDT 1:128
	
	MOVLW	B'00100000'
	MOVWF	PIE1		; LIGA A INTERRUPÇÃO SERIAL
	
	MOVLW	B'01000000'	
	MOVWF	INTCON		; HABILITA A INTERRUPÇÃO DOS PERIFÉRICOS
				; LIGA A CHAVE GERAL DE INTERRUPÇÃO
	
	MOVLW	B'00000111'	; DESLIGA OS A/D´S
	MOVWF	ADCON1
	
	MOVLW	.25
	MOVWF	SPBRG		; PREPARA PARA FUNCIONAR A 9600bps
	
	MOVLW	B'00100100'
	MOVWF	TXSTA		; CONFIGURA USART
	
	BANK0
	
	MOVLW	B'10010000'
	MOVWF	RCSTA		; CONFIGURA USART
		
	BTFSC	STATUS,NOT_TO	; ESTOURO POR WDT?
	GOTO	$		; NÃO, ENTÃO AGUARDA
		
LIMPEZA_DA_RAM
				; ROTINA DE LIMPEZA DA RAM
				
	MOVLW	0x20
	MOVWF	FSR
	CLRF	INDF
	INCF	FSR,F
	MOVLW	0x80
	XORWF	FSR,W
	BTFSS	STATUS,Z
	GOTO	$-5

	BSF	INTCON,GIE	; LIGA AS INTERRUPÇÕES
	
;*	*	*	*	*	*	*	*	*	*
;*         	         INICIALIZAÇÃO DO DISPLAY			*
;*	*	*	*	*	*	*	*	*	*
	


	MOVLW	0x30			
	CALL	ENVIA_COMANDO		; COMANDO DE INICIALIZAÇÃO
	
	MOVLW	.3			
	CALL	DELAY_MS		; DELAY DE 3ms
	
	MOVLW	0x30			
	CALL	ENVIA_COMANDO		; COMANDO DE INICIALIZAÇÃO	
	
	MOVLW	0x30			
	CALL	ENVIA_COMANDO		; COMANDO DE INICIALIZAÇÃO
	
	MOVLW	0x38			
	CALL	ENVIA_COMANDO		; INTERFACE DE 8 VIAS
	
	MOVLW	0x01			
	CALL	ENVIA_COMANDO		; LIMPA O DISPLAY
	
	MOVLW	.1
	CALL	DELAY_MS		; CHAMA DELAY DE 3ms
	
	MOVLW	0x0C			
	CALL	ENVIA_COMANDO		; LIGAR O DISPLAY SEM CURSOR
	
	MOVLW	0x06			
	CALL	ENVIA_COMANDO		; LIGAR O DISPLAY SEM CURSOR
	
								
;*	*	*	*	*	*	*	*	*	*
;*         	         INICIALIZAÇÃO DAS VARIÁVEIS			*
;*	*	*	*	*	*	*	*	*	*
	
	CALL	TELA_INICIAL
	
;*	*	*	*	*	*	*	*	*	*
;*		            ROTINA PRINCIPAL				*
;*	*	*	*	*	*	*	*	*	*

LOOP
	CLRWDT			; LIMPA O WATCHDOG
	
	BTFSS	PODE_CONVERTER  ; PODE APILCAR AS QUATRO OPERAÇÕES BÁSICAS?
	GOTO	LOOP		; NÃO, ENTÃO SALTA PARA O LOOP PRINCIPAL
	CALL	SOM		; CHAMA ROTINA DE SOMA	
	CALL	SUB		; CHAMA ROTINA DE SUBTRAÇÃO
	CALL	MUL		; CHAMA ROTINA DE MULTIPLICAÇÃO
	CALL	DIV		; CHAMA ROTINA DE DIVISÃO
	BCF	PODE_CONVERTER	; LIMPA O FLAG DE CONVERSÃO
	GOTO	LOOP		; SALTA PARA O LOOP PRINCIPAL
		
;*	*	*	*	*	*	*	*	*	*
;*		             FIM DO PROGRAMA				*
;*	*	*	*	*	*	*	*	*	*

	END			; FIM DO PROGRAMA


