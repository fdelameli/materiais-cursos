;*	*	*	*	*	*	*	*	*	*
;*			Programação em Assembly				*
;*	            EXEMPLO10: UTILIZANDO O PWM DO PIC 			*
;*		     APOSTILA MÓDULO B  -  PIC16F877A			*
;*		      CERNE TECNOLOGIA E TREINAMENTO			*
;*	    VERSÃO 1.0				DATA:14/05/2005		*
;*									*
;*	*	*	*	*	*	*	*	*	*

;*	*	*	*	*	*	*	*	*	*
;*			 OBJETIVO DO ARQUIVO FONTE			*
;*									*
;*  CONTROLAR A ROTAÇÃO DO VENTILADOR EXTERNO E DO RESITOR DE POTÊNCIA	*
;*  A PARTIR DO CONTROLE QUE SERÁ FEITO NO TECLADO MATRICIAL. O VALOR   *
;*    AJUSTADO SERÁ APRESENTADO NO DISPLAY E AJUSTADO NO MÓDULO CCP	*
;*									*
;*	*	*	*	*	*	*	*	*	*

 #INCLUDE <P16F877.INC> 	;ARQUIVO PADRÃO PARA PIC16F877A
 __CONFIG _CP_OFF & _XT_OSC & _PWRTE_ON & _LVP_OFF & _WDT_ON & _BODEN_OFF & _CPD_OFF & _DEBUG_OFF
 	
 	;NESTE PONTO É INFORMADO A CONFIGURAÇÃO DA MÁQUINA, OU SEJA, SE TERÁ
 	;CÓDIGO DE PROTEÇÃO OU O TIPO DE CRISTAL QUE SERÁ UTILIZADO	

 	;CONFIGURAÇÃO DA MÁQUINA
 	; CODE PROTECT		        -> DESLIGADO
 	; OSCILADOR    		        -> CRISTAL OU RESSONADOR
 	; POWER-UP     		        -> LIGADO
 	; DEBUF 		        -> DESLIGADO		
 	; PROGRAMAÇÃO EM BAIXA VOLTAGEM -> DESLIGADO
	; WATCH DOG			-> LIGADO
	; BROWN-OUT RESET		-> DESLIGADO
	; PROTEÇÃO DE EEPROM		-> DESLIGADO
	 	
;*	*	*	*	*	*	*	*	*	*
;*			   PAGINAÇÃO DE MEMÓRIA				*
;*	*	*	*	*	*	*	*	*	*

; AQUI CRIAREMOS UM PSEUDÔNIMO PARA UM COMANDO. POR EXEMPLO, O COMANDO
; "BCF STATUS,RP0" PODE SER SUBSTITUÍDO SEM PROBLEMAS POR "BANK0". O 
; COMPILADOR IRÁ SUBSTITUIR INTERNAMENTE "BANK0" POR "BCF STATUS,RP0".
; ESTA APLICAÇÃO É VÁLIDA PARA OUTROS TIPOS DE COMANDOS

#DEFINE	BANK0	BCF	STATUS,RP0	; ESCOLHE BANCO DE MEMÓRIA 0
#DEFINE	BANK1	BSF	STATUS,RP0	; ESCOLHE BANCO DE MEMÓRIA 1

;*	*	*	*	*	*	*	*	*	*
;*			     DEFINICAO DE RAM				*
;*	*	*	*	*	*	*	*	*	*

; AQUI IREMOS CRIAR AS VARIÁVEIS DO NOSSO SISTEMA

	CBLOCK 0x20	 ; INÍCIO DO BLOCO DE RAM(GPR)
		TEMPO1   ; VARIÁVEL DA ROTINA DE TEMPO		
		TEMPO2   ; VARIÁVEL DA ROTINA DE TEMPO				
		TECLADO1 ; VARIÁVEL PARA MARCAR AS TECLAS  
		TECLADO2 ; VARIÁVEL PARA MARCAR AS TECLAS
		INDICE	 ; VARIÁVEL DE ÍNDICE
		TEMP	 ; VARIÁVEL TEMPORÁRIA		
	ENDC		 ; FIM DO BLOCO DE RAM(GPR)
	
	CBLOCK 0x70
		W_TEMP	 ; VARIÁVEIS TEMPORÁRIAS
		STATUS_TEMP	
		FSR_TEMP
		PCLATH_TEMP
	ENDC
		
;*	*	*	*	*	*	*	*	*	*
;*		          DEFINICAO DE FLAGS				*
;*	*	*	*	*	*	*	*	*	*

; AQUI SÃO DEFINIDOS OS FLAGS QUE SERÃO UTILIZADOS PELO SISTEMA

#DEFINE  TECLA_0	TECLADO1,0  ; TECLA 0 DO TECLADO MATRICIAL
#DEFINE  TECLA_1	TECLADO1,1  ; TECLA 1 DO TECLADO MATRICIAL	
#DEFINE  TECLA_2	TECLADO1,2  ; TECLA 2 DO TECLADO MATRICIAL	
#DEFINE  TECLA_3	TECLADO1,3  ; TECLA 3 DO TECLADO MATRICIAL
#DEFINE  TECLA_4	TECLADO1,4  ; TECLA 4 DO TECLADO MATRICIAL
#DEFINE  TECLA_5	TECLADO1,5  ; TECLA 5 DO TECLADO MATRICIAL
#DEFINE  TECLA_6	TECLADO1,6  ; TECLA 6 DO TECLADO MATRICIAL
#DEFINE  TECLA_7	TECLADO1,7  ; TECLA 7 DO TECLADO MATRICIAL
#DEFINE  TECLA_8	TECLADO2,0  ; TECLA 8 DO TECLADO MATRICIAL
#DEFINE  TECLA_9	TECLADO2,1  ; TECLA 9 DO TECLADO MATRICIAL
#DEFINE  TECLA_C	TECLADO2,2  ; TECLA CORRIGE DO TECLADO MATRICIAL
#DEFINE  TECLA_E	TECLADO2,3  ; TECLA ENTER DO TECLADO MATRICIAL
	
;*	*	*	*	*	*	*	*	*	*
;*		        DEFINICAO DE CONSTANTES				*
;*	*	*	*	*	*	*	*	*	*

; AQUI SÃO DEFINIDOS AS CONSTANTES QUE SERÃO UTILIZADOS PELO SISTEMA

#DEFINE LINHA_SUP	0x80	; CONSTANTE PARA LINHA SUPERIOR
#DEFINE LINHA_INF	0xC0	; CONSTANTE PARA LINHA INFERIOR

#DEFINE SEL_LINHA1	B'00001110'  ; SELECIONA LINHA 1	
#DEFINE SEL_LINHA2	B'00001101'  ; SELECIONA LINHA 2		
#DEFINE SEL_LINHA3	B'00001011'  ; SELECIONA LINHA 3		
#DEFINE SEL_LINHA4	B'00000111'  ; SELECIONA LINHA 4	

;*	*	*	*	*	*	*	*	*	*
;*			  ENTRADAS DO SISTEMA				*
;*	*	*	*	*	*	*	*	*	*

#DEFINE COL1		PORTA,4	     ; PINO DE ENTRADA DA COLUNA1	
#DEFINE COL2		PORTA,5	     ; PINO DE ENTRADA DA COLUNA2		
#DEFINE COL3		PORTE,0	     ; PINO DE ENTRADA DA COLUNA3		

;*	*	*	*	*	*	*	*	*	*
;*			  SAÍDAS DO SISTEMA				*
;*	*	*	*	*	*	*	*	*	*

; AQUI SÃO DEFINIDAS AS SAÍDAS QUE SERÃO UTILIZADOS PELO SISTEMA

#DEFINE BUS		PORTD	; DEFINE O BARRAMENTO COMO O PORTD 
#DEFINE RS		PORTE,1	; RS DO DISPLAY
#DEFINE EN		PORTE,2 ; EN DO DISPLAY

;*	*	*	*	*	*	*	*	*	*
;*			    VETOR DE RESET				*
;*	*	*	*	*	*	*	*	*	*

	ORG 	0x0000		; ENDEREÇO INICIAL DA MÁQUINA
	GOTO	CONFIG_		; SALTA PARA CONFIGURAR A MÁQUINA

;*	*	*	*	*	*	*	*	*	*
;*		         VETOR DE INTERRUPÇÃO				*
;*	*	*	*	*	*	*	*	*	*

	ORG 	0x0004		; ENDEREÇO INICIAL DO VETOR DE INTERRUPÇÃO
SALVA_CONTEXTO
	MOVWF	W_TEMP		; SALVA W
	SWAPF	STATUS,W	
	MOVWF	STATUS_TEMP	; SALVA STATUS
	MOVF	FSR,W
	MOVWF	FSR_TEMP	; SALVA FSR	
	MOVF	PCLATH,W	
	MOVWF	PCLATH_TEMP	; SALVA PCLATH
	
	CLRF	STATUS		; GARANTE BANCO 0
	CLRF	PCLATH		; GARANTE PÁGINA 0
	
	BTFSC	INTCON,T0IF	; INTERRUPÇÃO DE TIMER0?
	GOTO	TRATA_TIMER0	; SIM, ENTÃO TRATA
	
SAI_INTERRUPCAO	
	MOVF	FSR_TEMP,W
	MOVWF	FSR		; RECUPERA FSR
	MOVF	PCLATH_TEMP,W	
	MOVWF	PCLATH		; RECUPERA PCLATH
	SWAPF	STATUS_TEMP,W
	MOVWF	STATUS		; RECUPERA STATUS
	SWAPF	W_TEMP,F
	SWAPF	W_TEMP,W	; RECUPERA W
	RETFIE			; RETORNA DA INTERRUPÇÃO

;*	*	*	*	*	*	*	*	*	*
;*     	            TRATATAMENTO DE INTERRUPÇÃO DE TIMER0		*
;*	*	*	*	*	*	*	*	*	*

TRATA_TIMER0
	
	BCF	INTCON,T0IF	 ; LIMPA FLAG DE INTERRUPÇÃO
	INCF	INDICE		 ; INCREMENTA INDICE 
	MOVLW	B'00000011'	 
	ANDWF	INDICE,W	 ; MASCARA OS BITS SUPERIORES	
	ADDWF	PCL,F	 	 ; SOMA CONTEÚDO COM PCL	
	GOTO	VERIFICA_LINHA1	 ; SALTA PARA TRATAR A LINHA 1
	GOTO	VERIFICA_LINHA2	 ; SALTA PARA TRATAR A LINHA 2
	GOTO	VERIFICA_LINHA3	 ; SALTA PARA TRATAR A LINHA 3
	GOTO	VERIFICA_LINHA4	 ; SALTA PARA TRATAR A LINHA 4
	

VERIFICA_LINHA1
	
	MOVLW	SEL_LINHA1	
	MOVWF	BUS		; SELECIONA A LINHA 1	
	
	BCF	TECLA_1		; LIMPA FLAG DA TECLA 1 PRESSIONADA
	BCF	TECLA_2		; LIMPA FLAG DA TECLA 2 PRESSIONADA
	BCF	TECLA_3		; LIMPA FLAG DA TECLA 3 PRESSIONADA
		
	BTFSS	COL1		; COLUNA1 ESTÁ PRESSIONADA?
	BSF	TECLA_1		; SIM, ENTÃO SETA TECLA_1
	
	BTFSS	COL2		; COLUNA2 ESTÁ PRESSIONADA?
	BSF	TECLA_2		; SIM, ENTÃO SETA TECLA_2
	
	BTFSS	COL3		; COLUNA3 ESTÁ PRESSIONADA?
	BSF	TECLA_3		; SIM, ENTÃO SETA TECLA_3
	
	GOTO	SAI_INTERRUPCAO	; SAI DA INTERRUPÇÃO
	
VERIFICA_LINHA2
	
	MOVLW	SEL_LINHA2
	MOVWF	BUS		; SELECIONA A LINHA 2	
	
	BCF	TECLA_4		; LIMPA FLAG DA TECLA 4 PRESSIONADA
	BCF	TECLA_5		; LIMPA FLAG DA TECLA 5 PRESSIONADA
	BCF	TECLA_6		; LIMPA FLAG DA TECLA 6 PRESSIONADA
		
	BTFSS	COL1		; COLUNA1 ESTÁ PRESSIONADA?
	BSF	TECLA_4		; SIM, ENTÃO SETA TECLA_4
	
	BTFSS	COL2		; COLUNA2 ESTÁ PRESSIONADA?
	BSF	TECLA_5		; SIM, ENTÃO SETA TECLA_5
	
	BTFSS	COL3		; COLUNA3 ESTÁ PRESSIONADA?
	BSF	TECLA_6		; SIM, ENTÃO SETA TECLA_6
	
	GOTO	SAI_INTERRUPCAO	; SAI DA INTERRUPÇÃO

VERIFICA_LINHA3
	
	MOVLW	SEL_LINHA3
	MOVWF	BUS		; SELECIONA A LINHA 3	
	
	BCF	TECLA_7		; LIMPA FLAG DA TECLA 7 PRESSIONADA
	BCF	TECLA_8		; LIMPA FLAG DA TECLA 8 PRESSIONADA
	BCF	TECLA_9		; LIMPA FLAG DA TECLA 9 PRESSIONADA
		
	BTFSS	COL1		; COLUNA1 ESTÁ PRESSIONADA?
	BSF	TECLA_7		; SIM, ENTÃO SETA TECLA_7
	
	BTFSS	COL2		; COLUNA2 ESTÁ PRESSIONADA?
	BSF	TECLA_8		; SIM, ENTÃO SETA TECLA_8
	
	BTFSS	COL3		; COLUNA3 ESTÁ PRESSIONADA?
	BSF	TECLA_9		; SIM, ENTÃO SETA TECLA_9
	
	GOTO	SAI_INTERRUPCAO	; SAI DA INTERRUPÇÃO

VERIFICA_LINHA4
	
	MOVLW	SEL_LINHA4	
	MOVWF	BUS		; SELECIONA A LINHA 4	
	
	BCF	TECLA_E		; LIMPA FLAG DA TECLA ENTER PRESSIONADA
	BCF	TECLA_C		; LIMPA FLAG DA TECLA CORRIGE PRESSIONADA
	BCF	TECLA_0		; LIMPA FLAG DA TECLA 0 PRESSIONADA
		
	BTFSS	COL1		; COLUNA1 ESTÁ PRESSIONADA?
	BSF	TECLA_C		; SIM, ENTÃO SETA TECLA_C
	
	BTFSS	COL2		; COLUNA2 ESTÁ PRESSIONADA?
	BSF	TECLA_0		; SIM, ENTÃO SETA TECLA_0
	
	BTFSS	COL3		; COLUNA3 ESTÁ PRESSIONADA?
	BSF	TECLA_E		; SIM, ENTÃO SETA TECLA_E
	
	GOTO	SAI_INTERRUPCAO	; SAI DA INTERRUPÇÃO

;*	*	*	*	*	*	*	*	*	*
;*	              ROTINA DE DELAY DE 1ms A 256ms			*
;*	*	*	*	*	*	*	*	*	*

DELAY_MS
	
	CLRWDT
	
	MOVWF	TEMPO2		; SALVA O VALOR MULTIPLICADOR
	CLRF	TEMPO1		; LIMPA REGISTRADOR

DELAY_A
	
	NOP			; PERDE 1 CICLO DE MÁQUINA
	DECFSZ	TEMPO1,F	; DECREMENTA REGISTRADOR, ACABOU?
	GOTO	$-2		; NÃO, ENTÃO RETORNA DUAS POSIÇÕES 
	DECFSZ	TEMPO2,F
	GOTO	DELAY_A
	
	RETURN			; RETORNA DA INTERRUPÇÃO

;*	*	*	*	*	*	*	*	*	*
;*	          ROTINA PARA ESCREVER DADOS NO DISPLAY			*
;*	*	*	*	*	*	*	*	*	*

ENVIA_COMANDO
	
	BCF	RS		; PÕE EM MODO DE COMANDO
	
ENVIA_DADO
	
	BCF	INTCON,GIE	; DESLIGA A INTERRUPÇÃO
	
	MOVWF	BUS		; MOVE DADO PARA O PORTD
		
	GOTO	$+1		; DEÇAY PARA ACOMODAÇÃO
	GOTO	$+1		
	
	BSF	EN		; GERA PULSO DE CLOCK
	GOTO	$+1
	BCF	EN
	
	BSF	RS		; VOLTA PARA O MODO DADOS
	MOVLW	.1
	CALL	DELAY_MS
	BSF	INTCON,GIE	; LIGA A INTERRUPÇÃO
	RETURN			; RETORNA DA INTERRUPÇÃO

;*	*	*	*	*	*	*	*	*	*
;*		     ROTINA DE ATUALIZAÇÃO DA TELA DO LCD 		*
;*	*	*	*	*	*	*	*	*	*

ATUALIZA_TELA
	
	
	MOVLW	0x80
	CALL	ENVIA_COMANDO	; COMANDO PARA POSICIONAR O DISPLAY
	
	MOVLW	'C'
	CALL	ENVIA_DADO	; ENVIA CARACTER ASCII	
	
	MOVLW	'C'
	CALL	ENVIA_DADO	; ENVIA CARACTER ASCII	
	
	MOVLW	'P'
	CALL	ENVIA_DADO	; ENVIA CARACTER ASCII	
	
	MOVLW	'1'
	CALL	ENVIA_DADO	; ENVIA CARACTER ASCII	
	
	MOVLW	'('
	CALL	ENVIA_DADO	; ENVIA CARACTER ASCII	
	
	MOVLW	'V'
	CALL	ENVIA_DADO	; ENVIA CARACTER ASCII	
	
	MOVLW	'e'
	CALL	ENVIA_DADO	; ENVIA CARACTER ASCII	
	
	MOVLW	'n'
	CALL	ENVIA_DADO	; ENVIA CARACTER ASCII	
	
	MOVLW	't'
	CALL	ENVIA_DADO	; ENVIA CARACTER ASCII	
	
	MOVLW	'}'
	CALL	ENVIA_DADO	; ENVIA CARACTER ASCII	
	
	MOVLW	':'
	CALL	ENVIA_DADO	; ENVIA CARACTER ASCII	
	
	MOVLW	' '
	CALL	ENVIA_DADO	; ENVIA CARACTER ASCII	
	
	MOVLW	'0'
	CALL	ENVIA_DADO	; ENVIA CARACTER ASCII	
	
	MOVLW	' '
	CALL	ENVIA_DADO	; ENVIA CARACTER ASCII	
	
	MOVLW	' '
	CALL	ENVIA_DADO	; ENVIA CARACTER ASCII	
	
	MOVLW	'%'
	CALL	ENVIA_DADO	; ENVIA CARACTER ASCII	
	
	MOVLW	0xC0
	CALL	ENVIA_COMANDO	; COMANDO PARA POSICIONAR O DISPLAY
	
	MOVLW	'C'
	CALL	ENVIA_DADO	; ENVIA CARACTER ASCII	
	
	MOVLW	'C'
	CALL	ENVIA_DADO	; ENVIA CARACTER ASCII	
	
	MOVLW	'P'
	CALL	ENVIA_DADO	; ENVIA CARACTER ASCII	
	
	MOVLW	'2'
	CALL	ENVIA_DADO	; ENVIA CARACTER ASCII	
	
	MOVLW	'('
	CALL	ENVIA_DADO	; ENVIA CARACTER ASCII	
	
	MOVLW	'R'
	CALL	ENVIA_DADO	; ENVIA CARACTER ASCII	
	
	MOVLW	'e'
	CALL	ENVIA_DADO	; ENVIA CARACTER ASCII	
	
	MOVLW	's'
	CALL	ENVIA_DADO	; ENVIA CARACTER ASCII	
	
	MOVLW	'i'
	CALL	ENVIA_DADO	; ENVIA CARACTER ASCII	
	
	MOVLW	'}'
	CALL	ENVIA_DADO	; ENVIA CARACTER ASCII	
	
	MOVLW	':'
	CALL	ENVIA_DADO	; ENVIA CARACTER ASCII	
	
	
	MOVLW	' '
	CALL	ENVIA_DADO	; ENVIA CARACTER ASCII	
		
	MOVLW	'0'
	CALL	ENVIA_DADO	; ENVIA CARACTER ASCII	
	
	MOVLW	' '
	CALL	ENVIA_DADO	; ENVIA CARACTER ASCII	
	
	MOVLW	' '
	CALL	ENVIA_DADO	; ENVIA CARACTER ASCII	
	
	MOVLW	'%'
	CALL	ENVIA_DADO	; ENVIA CARACTER ASCII	
	
	RETURN			; RETORNA DA ROTINA	

ATUALIZA_0
	
	MOVWF	TEMP
	
	XORLW	0x8B 		; VERIFICA SE É PARA ATUALIZAR
	MOVLW	.0		; O CCP1 OU O CCP2
	BTFSS	STATUS,Z
	MOVWF	CCPR2L
	BTFSC	STATUS,Z
	MOVWF	CCPR1L
	
	MOVF	TEMP,W		; POSICIONA LINHA DO DISPLAY
	CALL	ENVIA_COMANDO	; CHAMA ROTINA PARA ENVIAR COMANDO
	
	MOVLW	' '
	CALL	ENVIA_DADO	; ENVIA CARACTER ASCII	
	
	MOVLW	'0'
	CALL	ENVIA_DADO	; ENVIA CARACTER ASCII	
	
	MOVLW	' '
	CALL	ENVIA_DADO	; ENVIA CARACTER ASCII	
	
	RETURN			; RETORNA DA ROTINA	


ATUALIZA_20
	
	MOVWF	TEMP
	
	XORLW	0x8B 		; VERIFICA SE É PARA ATUALIZAR
	MOVLW	.50		; O CCP1 OU O CCP2
	BTFSS	STATUS,Z
	MOVWF	CCPR2L
	BTFSC	STATUS,Z
	MOVWF	CCPR1L

	MOVF	TEMP,W
	CALL	ENVIA_COMANDO	; CHAMA ROTINA PARA ENVIAR COMANDO
	
	MOVLW	' '
	CALL	ENVIA_DADO	; ENVIA CARACTER ASCII	
	
	MOVLW	'2'
	CALL	ENVIA_DADO	; ENVIA CARACTER ASCII	
	
	MOVLW	'0'
	CALL	ENVIA_DADO	; ENVIA CARACTER ASCII	
	
	RETURN			; RETORNA DA ROTINA	

ATUALIZA_40
	
	MOVWF	TEMP
	
	XORLW	0x8B 		; VERIFICA SE É PARA ATUALIZAR
	MOVLW	.101		; O CCP1 OU O CCP2
	BTFSS	STATUS,Z
	MOVWF	CCPR2L
	BTFSC	STATUS,Z
	MOVWF	CCPR1L

	MOVF	TEMP,W
	CALL	ENVIA_COMANDO	; CHAMA ROTINA PARA ENVIAR COMANDO
	
	MOVLW	' '
	CALL	ENVIA_DADO	; ENVIA CARACTER ASCII	
	
	MOVLW	'4'
	CALL	ENVIA_DADO	; ENVIA CARACTER ASCII	
	
	MOVLW	'0'
	CALL	ENVIA_DADO	; ENVIA CARACTER ASCII	
	
	RETURN			; RETORNA DA ROTINA	

ATUALIZA_60
	
	MOVWF	TEMP
	
	XORLW	0x8B 		; VERIFICA SE É PARA ATUALIZAR
	MOVLW	.152		; O CCP1 OU O CCP2
	BTFSS	STATUS,Z
	MOVWF	CCPR2L
	BTFSC	STATUS,Z
	MOVWF	CCPR1L

	MOVF	TEMP,W
	CALL	ENVIA_COMANDO	; CHAMA ROTINA PARA ENVIAR COMANDO
	
	MOVLW	' '
	CALL	ENVIA_DADO	; ENVIA CARACTER ASCII	
	
	MOVLW	'6'
	CALL	ENVIA_DADO	; ENVIA CARACTER ASCII	
	
	MOVLW	'0'
	CALL	ENVIA_DADO	; ENVIA CARACTER ASCII	
	
	RETURN			; RETORNA DA ROTINA	

ATUALIZA_80
	
	MOVWF	TEMP
	
	XORLW	0x8B 		; VERIFICA SE É PARA ATUALIZAR
	MOVLW	.203		; O CCP1 OU O CCP2
	BTFSS	STATUS,Z
	MOVWF	CCPR2L
	BTFSC	STATUS,Z
	MOVWF	CCPR1L

	MOVF	TEMP,W
	CALL	ENVIA_COMANDO	; CHAMA ROTINA PARA ENVIAR COMANDO
	
	MOVLW	' '
	CALL	ENVIA_DADO	; ENVIA CARACTER ASCII	
	
	MOVLW	'8'
	CALL	ENVIA_DADO	; ENVIA CARACTER ASCII	
	
	MOVLW	'0'
	CALL	ENVIA_DADO	; ENVIA CARACTER ASCII	
	
	RETURN			; RETORNA DA ROTINA	

ATUALIZA_100
	
	MOVWF	TEMP
	
	XORLW	0x8B 		; VERIFICA SE É PARA ATUALIZAR
	MOVLW	.255		; O CCP1 OU O CCP2
	BTFSS	STATUS,Z
	MOVWF	CCPR2L
	BTFSC	STATUS,Z
	MOVWF	CCPR1L

	MOVF	TEMP,W
	CALL	ENVIA_COMANDO	; CHAMA ROTINA PARA ENVIAR COMANDO
	
	MOVLW	'1'
	CALL	ENVIA_DADO	; ENVIA CARACTER ASCII	
	
	MOVLW	'0'
	CALL	ENVIA_DADO	; ENVIA CARACTER ASCII	
	
	MOVLW	'0'
	CALL	ENVIA_DADO	; ENVIA CARACTER ASCII	
	
	RETURN			; RETORNA DA ROTINA	
			
;*	*	*	*	*	*	*	*	*	*
;*		          CONFIGURACOES INICIAIS			*
;*	*	*	*	*	*	*	*	*	*

CONFIG_

	CLRF	PORTA		; LIMPA O PORTA
	CLRF	PORTB		; LIMPA O PORTB
	CLRF	PORTC		; LIMPA O PORTC
	CLRF	PORTD		; LIMPA O PORTD
	CLRF	PORTE		; LIMPA O PORTE
	
	BANK1			; SELECIONA BANCO1 DE MEMÓRIA
	
	MOVLW	B'11111111'
	MOVWF	TRISA
	
	MOVLW	B'11000000'
	MOVWF	TRISB		; CONFIGURA I/O DO PORTB
	
	MOVLW	B'11011001'
	MOVWF	TRISC		; CONFIGURA I/O DO PORTB
	
	MOVLW	B'00000000'	; CONFIGURA TODOS OS PINOS DESTE
	MOVWF	TRISD		; PORTB COMO SAÍDA
	
	MOVLW	B'00000001'
	MOVWF	TRISE		; CONFIGURA I/O DO PORTE
	
	MOVLW	B'10001111'	; DESLIGA PULL-UPS
	MOVWF	OPTION_REG	; WDT 1:128
	
	MOVLW	B'00100000'	
	MOVWF	INTCON		; HABILITA A INTERRUPÇÃO DE TIMER 0
				; LIGA A CHAVE GERAL DE INTERRUPÇÃO
	
	MOVLW	B'00000111'	; DESLIGA OS A/D´S
	MOVWF	ADCON1
	
	MOVLW	.249
	MOVWF	PR2		; CONFIGURA BASE DE TEMPO PARA 4kHz
	
	BANK0
	
	MOVLW	B'00000101'
	MOVWF	T2CON		; TIMER 2 ON
				; PRESCALER 1:4
	
	MOVLW	B'00001111'
	MOVWF	CCP1CON
	MOVWF	CCP2CON		; CONFIGURA CCP PARA MODO PWM
	
	CLRF	CCPR1L
	CLRF	CCPR2L		; INICIALIZA OS MÓDULOS	
	
	BTFSC	STATUS,NOT_TO	; ESTOURO POR WDT?
	GOTO	$		; NÃO, ENTÃO AGUARDA
		
LIMPEZA_DA_RAM
				; ROTINA DE LIMPEZA DA RAM
				
	MOVLW	0x20
	MOVWF	FSR
	CLRF	INDF
	INCF	FSR,F
	MOVLW	0x80
	XORWF	FSR,W
	BTFSS	STATUS,Z
	GOTO	$-5

	BSF	INTCON,GIE	; LIGA AS INTERRUPÇÕES
	
;*	*	*	*	*	*	*	*	*	*
;*         	         INICIALIZAÇÃO DO DISPLAY			*
;*	*	*	*	*	*	*	*	*	*
	


	MOVLW	0x30			
	CALL	ENVIA_COMANDO		; COMANDO DE INICIALIZAÇÃO
	
	MOVLW	.3			
	CALL	DELAY_MS		; DELAY DE 3ms
	
	MOVLW	0x30			
	CALL	ENVIA_COMANDO		; COMANDO DE INICIALIZAÇÃO	
	
	MOVLW	0x30			
	CALL	ENVIA_COMANDO		; COMANDO DE INICIALIZAÇÃO
	
	MOVLW	0x38			
	CALL	ENVIA_COMANDO		; INTERFACE DE 8 VIAS
	
	MOVLW	0x01			
	CALL	ENVIA_COMANDO		; LIMPA O DISPLAY
	
	MOVLW	.1
	CALL	DELAY_MS		; CHAMA DELAY DE 3ms
	
	MOVLW	0x0C			
	CALL	ENVIA_COMANDO		; LIGAR O DISPLAY SEM CURSOR
	
	MOVLW	0x06			
	CALL	ENVIA_COMANDO		; LIGAR O DISPLAY SEM CURSOR
	
								
;*	*	*	*	*	*	*	*	*	*
;*         	         INICIALIZAÇÃO DAS VARIÁVEIS			*
;*	*	*	*	*	*	*	*	*	*
	
	CALL	ATUALIZA_TELA		; CHAMA ROTINA PARA ATUALIZAR
					; A TELA DA PLACA
		
;*	*	*	*	*	*	*	*	*	*
;*		            ROTINA PRINCIPAL				*
;*	*	*	*	*	*	*	*	*	*

LOOP
	CLRWDT			; LIMPA O WATCHDOG

AJUSTA_CCP1
	
	MOVLW	0x8B		; MOVE POSIÇÃO INICIAL DA MENSAGEM
	BTFSC	TECLA_1		; A TECLA ESTÁ PRESSIONADA?
	CALL	ATUALIZA_0	; SIM, ENTÃO CHAMA A ROTINA DE ATUALIZAÇÃO
	
	MOVLW	0x8B		; MOVE POSIÇÃO INICIAL DA MENSAGEM
	BTFSC	TECLA_2		; A TECLA ESTÁ PRESSIONADA?
	CALL	ATUALIZA_20	; SIM, ENTÃO CHAMA A ROTINA DE ATUALIZAÇÃO
	
	MOVLW	0x8B		; MOVE POSIÇÃO INICIAL DA MENSAGEM
	BTFSC	TECLA_3		; A TECLA ESTÁ PRESSIONADA?
	CALL	ATUALIZA_40	; SIM, ENTÃO CHAMA A ROTINA DE ATUALIZAÇÃO
	
	MOVLW	0x8B		; MOVE POSIÇÃO INICIAL DA MENSAGEM
	BTFSC	TECLA_4		; A TECLA ESTÁ PRESSIONADA?
	CALL	ATUALIZA_60	; SIM, ENTÃO CHAMA A ROTINA DE ATUALIZAÇÃO
	
	MOVLW	0x8B		; MOVE POSIÇÃO INICIAL DA MENSAGEM
	BTFSC	TECLA_5		; A TECLA ESTÁ PRESSIONADA?
	CALL	ATUALIZA_80	; SIM, ENTÃO CHAMA A ROTINA DE ATUALIZAÇÃO
	
	MOVLW	0x8B		; MOVE POSIÇÃO INICIAL DA MENSAGEM
	BTFSC	TECLA_6		; A TECLA ESTÁ PRESSIONADA?
	CALL	ATUALIZA_100	; SIM, ENTÃO CHAMA A ROTINA DE ATUALIZAÇÃO

AJUSTA_CCP2
	
	MOVLW	0xCB		; MOVE POSIÇÃO INICIAL DA MENSAGEM
	BTFSC	TECLA_7		; A TECLA ESTÁ PRESSIONADA?
	CALL	ATUALIZA_0	; SIM, ENTÃO CHAMA A ROTINA DE ATUALIZAÇÃO
	
	MOVLW	0xCB		; MOVE POSIÇÃO INICIAL DA MENSAGEM
	BTFSC	TECLA_8		; A TECLA ESTÁ PRESSIONADA?
	CALL	ATUALIZA_20	; SIM, ENTÃO CHAMA A ROTINA DE ATUALIZAÇÃO
	
	MOVLW	0xCB		; MOVE POSIÇÃO INICIAL DA MENSAGEM
	BTFSC	TECLA_9		; A TECLA ESTÁ PRESSIONADA?
	CALL	ATUALIZA_40	; SIM, ENTÃO CHAMA A ROTINA DE ATUALIZAÇÃO
	
	MOVLW	0xCB		; MOVE POSIÇÃO INICIAL DA MENSAGEM
	BTFSC	TECLA_C		; A TECLA ESTÁ PRESSIONADA?
  	CALL	ATUALIZA_60	; SIM, ENTÃO CHAMA A ROTINA DE ATUALIZAÇÃO
	
	MOVLW	0xCB		; MOVE POSIÇÃO INICIAL DA MENSAGEM
	BTFSC	TECLA_0		; A TECLA ESTÁ PRESSIONADA?
	CALL	ATUALIZA_80	; SIM, ENTÃO CHAMA A ROTINA DE ATUALIZAÇÃO
	
	MOVLW	0xCB		; MOVE POSIÇÃO INICIAL DA MENSAGEM
	BTFSC	TECLA_E		; A TECLA ESTÁ PRESSIONADA?
	CALL	ATUALIZA_100	; SIM, ENTÃO CHAMA A ROTINA DE ATUALIZAÇÃO
	
	GOTO	LOOP		; SALTA PARA O LOOP PRINCIPAL
		
;*	*	*	*	*	*	*	*	*	*
;*		             FIM DO PROGRAMA				*
;*	*	*	*	*	*	*	*	*	*


	END			; FIM DO PROGRAMA


