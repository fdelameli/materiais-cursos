;*	*	*	*	*	*	*	*	*	*
;*			  Programação em Assembly 			* 
;*  EXEMPLO1: RELÓGIO DIGITAL COM VARREDURA DE DISPLAY DE 7 SEGMENTOS	*
;*		     APOSTILA MÓDULO B  -  PIC16F877A			*
;*		      CERNE TECNOLOGIA E TREINAMENTO			*
;*	    VERSÃO 1.0				DATA:03/05/2005		*
;*									*
;*	*	*	*	*	*	*	*	*	*

;*	*	*	*	*	*	*	*	*	*
;*			 OBJETIVO DO ARQUIVO FONTE			*
;*									*
;*	 RELÓGIO DIGITAL COM VARREDURA DE DISPLAY DE 7 SEGMENTOS	*
;*									*
;*	*	*	*	*	*	*	*	*	*

 #INCLUDE <P16F877.INC> 	;ARQUIVO PADRÃO PARA PIC16F877A
 __CONFIG _CP_OFF & _XT_OSC & _PWRTE_ON & _LVP_OFF & _WDT_ON & _BODEN_OFF & _CPD_OFF & _DEBUG_OFF
 	
 	;NESTE PONTO É INFORMADO A CONFIGURAÇÃO DA MÁQUINA, OU SEJA, SE TERÁ
 	;CÓDIGO DE PROTEÇÃO OU O TIPO DE CRISTAL QUE SERÁ UTILIZADO	

 	;CONFIGURAÇÃO DA MÁQUINA
 	; CODE PROTECT		        -> DESLIGADO
 	; OSCILADOR    		        -> CRISTAL OU RESSONADOR
 	; POWER-UP     		        -> LIGADO
 	; DEBUF 		        -> DESLIGADO		
 	; PROGRAMAÇÃO EM BAIXA VOLTAGEM -> DESLIGADO
	; WATCH DOG			-> LIGADO
	; BROWN-OUT RESET		-> DESLIGADO
	; PROTEÇÃO DE EEPROM		-> DESLIGADO
	 	
;*	*	*	*	*	*	*	*	*	*
;*			   PAGINAÇÃO DE MEMÓRIA				*
;*	*	*	*	*	*	*	*	*	*

; AQUI CRIAREMOS UM PSEUDÔNIMO PARA UM COMANDO. POR EXEMPLO, O COMANDO
; "BCF STATUS,RP0" PODE SER SUBSTITUÍDO SEM PROBLEMAS POR "BANK0". O 
; COMPILADOR IRÁ SUBSTITUIR INTERNAMENTE "BANK0" POR "BCF STATUS,RP0".
; ESTA APLICAÇÃO É VÁLIDA PARA OUTROS TIPOS DE COMANDOS

#DEFINE	BANK0	BCF	STATUS,RP0	; ESCOLHE BANCO DE MEMÓRIA 0
#DEFINE	BANK1	BSF	STATUS,RP0	; ESCOLHE BANCO DE MEMÓRIA 1

;*	*	*	*	*	*	*	*	*	*
;*			     DEFINICAO DE RAM				*
;*	*	*	*	*	*	*	*	*	*

; AQUI IREMOS CRIAR AS VARIÁVEIS DO NOSSO SISTEMA

	CBLOCK 0x20	; INÍCIO DO BLOCO DE RAM(GPR)
		MILHAR	; REGISTRADOR DO MILHAR
		CENTENA	; REGISTRADOR DA CENTENA
		DEZENA	; REGISTRADOR DA DEZENA
		UNIDADE	; REGISTRADOR DA UNIDADE
		INDICE_DISPLAY ; INDICE PARA O DISPLAY
		TEMP_INT       ; VARIÁVEL DE USO GERAL DA INTERRUPÇÃO
		VEZES_TMR1     ; VARIÁVEL PARA CONTAR 1s 	
		FLAGS	       ; VARIÁVEL DE FLAGS DO SISTEMA	
	ENDC		; FIM DO BLOCO DE RAM(GPR)
	
	CBLOCK 0x70	; INÍCIO DO BLOCO DE RAM ESPELHADO(GPR)
		W_TEMP		; REGISTRADORES TEMPORÁRIOS
		STATUS_TEMP
		FSR_TEMP
		PCLATH_TEMP
	ENDC		; FIM DO BLOCO DE RAM ESPELHADO(GPR)
	
;*	*	*	*	*	*	*	*	*	*
;*		          DEFINICAO DE FLAGS				*
;*	*	*	*	*	*	*	*	*	*

; AQUI SÃO DEFINIDOS OS FLAGS QUE SERÃO UTILIZADOS PELO SISTEMA
	
#DEFINE	 PISCA	FLAGS,0	; DEFINE FLAG PARA PISCAR O DISPLAY
	
;*	*	*	*	*	*	*	*	*	*
;*		        DEFINICAO DE CONSTANTES				*
;*	*	*	*	*	*	*	*	*	*

; AQUI SÃO DEFINIDOS AS CONSTANTES QUE SERÃO UTILIZADOS PELO SISTEMA

#DEFINE TMR1_H	HIGH (.65536-.62500)	; DEFINE CONSTANTES 
#DEFINE TMR1_L	LOW  (.65536-.62500)  	; PARA BASE DE TEMPO	

;*	*	*	*	*	*	*	*	*	*
;*			   ENTRADAS DO SISTEMA				*
;*	*	*	*	*	*	*	*	*	*
; AQUI SÃO DEFINIDAS AS ENTRADAS QUE SERÃO UTILIZADOS PELO SISTEMA

;*	*	*	*	*	*	*	*	*	*
;*			    SAÍDAS DO SISTEMA				*
;*	*	*	*	*	*	*	*	*	*
; AQUI SÃO DEFINIDAS AS SAÍDAS QUE SERÃO UTILIZADOS PELO SISTEMA

#DEFINE BUS		PORTD	; DEFINE O BARRAMENTO COMO O PORTD 
#DEFINE SEL_UNIDADE	PORTB,4	; SELECIONA DISPLAY DA UNIDADE DE MILHAR
#DEFINE SEL_DEZENA	PORTB,3	; SELECIONA DISPLAY DA CENTENA
#DEFINE SEL_CENTENA	PORTB,2	; SELECIONA DISPLAY DA DEZENA
#DEFINE SEL_MILHAR	PORTB,1	; SELECIONA DISPLAY DA UNIDADE

;*	*	*	*	*	*	*	*	*	*
;*			    VETOR DE RESET				*
;*	*	*	*	*	*	*	*	*	*

	ORG 	0x0000		; ENDEREÇO INICIAL DA MÁQUINA
	GOTO	CONFIG_		; SALTA PARA CONFIGURAR A MÁQUINA

;*	*	*	*	*	*	*	*	*	*
;*		         VETOR DE INTERRUPÇÃO				*
;*	*	*	*	*	*	*	*	*	*

	ORG 	0x0004		; ENDEREÇO INICIAL DO VETOR DE INTERRUPÇÃO
SALVA_CONTEXTO
	MOVWF	W_TEMP		; SALVA W
	SWAPF	STATUS,W	
	MOVWF	STATUS_TEMP	; SALVA STATUS
	MOVF	FSR,W
	MOVWF	FSR_TEMP	; SALVA FSR	
	MOVF	PCLATH,W	
	MOVWF	PCLATH_TEMP	; SALVA PCLATH
	
	CLRF	STATUS		; GARANTE BANCO 0
	CLRF	PCLATH		; GARANTE PÁGINA 0
	
	BTFSC	INTCON,T0IF	; INTERRUPÇÃO DE TIMER0?
	GOTO	TRATA_TIMER0	; SIM, ENTÃO TRATA
	
	BTFSC	PIR1,TMR1IF	; INTERRUPÇÃO DE TIMER1?
	GOTO	TRATA_TIMER1	; SIM, ENTÃO TRATA
	
SAI_INTERRUPCAO	
	MOVF	FSR_TEMP,W
	MOVWF	FSR		; RECUPERA FSR
	MOVF	PCLATH_TEMP,W	
	MOVWF	PCLATH		; RECUPERA PCLATH
	SWAPF	STATUS_TEMP,W
	MOVWF	STATUS		; RECUPERA STATUS
	SWAPF	W_TEMP,F
	SWAPF	W_TEMP,W	; RECUPERA W
	RETFIE			; RETORNA DA INTERRUPÇÃO

;*	*	*	*	*	*	*	*	*	*
;*     	            TRATATAMENTO DE INTERRUPÇÃO DE TIMER0		*
;*	*	*	*	*	*	*	*	*	*

TRATA_TIMER0
	
	BCF	INTCON,T0IF	 ; LIMPA FLAG DE INTERRUPÇÃO
	INCF	INDICE_DISPLAY,F ; INCREMENTA INDICE DOS DISPLAYS
	MOVLW	B'00000011'	 
	ANDWF	INDICE_DISPLAY,W ; MASCARA OS BITS SUPERIORES	
	ADDWF	PCL,F	 	 ; SOMA CONTEÚDO COM PCL	
	GOTO	DISPLAY_MILHAR	 ; MOSTRA DISPLAY DE MILHAR
	GOTO	DISPLAY_CENTENA	 ; MOSTRA DISPLAY DE CENTENA
	GOTO	DISPLAY_DEZENA   ; MOSTRA DISPLAY DE DEZENA
	GOTO	DISPLAY_UNIDADE  ; MOSTRA DISPLAY DE UNIDADE
	
DISPLAY_MILHAR
	
	BCF	SEL_UNIDADE	; DESLIGA SELEÇÃO DE UNIDADE

	MOVF	MILHAR,W	; MOVE CONTEÚDO DE MILHAR PARA W
	CALL	CONVERTE	; CHAMA ROTINA DE CONVERSÃO
	MOVWF	BUS		; MOVE DADO PARA O BARRAMENTO
	BSF	SEL_MILHAR	; SELECIONA O DISPLAY DE MILHAR
	GOTO	SAI_INTERRUPCAO	; SAI DA INTERRUPÇÃO
	

DISPLAY_CENTENA
	
	BCF	SEL_MILHAR	; DESLIGA SELEÇÃO DE MILHAR
		
	MOVF	CENTENA,W	; MOVE CONTEÚDO DE CENTENA PARA W
	CALL	CONVERTE	; CHAMA ROTINA DE CONVERSÃO
	MOVWF	BUS		; MOVE DADO PARA O BARRAMENTO
	BTFSC	PISCA		; DEVE ACENDER O PONTO?
	BSF	BUS,7		; SIM!
	BSF	SEL_CENTENA	; SELECIONA O DISPLAY DE CENTENA
	GOTO	SAI_INTERRUPCAO	; SAI DA INTERRUPÇÃO
			
DISPLAY_DEZENA
	

	BCF	SEL_CENTENA	; DESLIGA SELEÇÃO DE CENTENA
		
	MOVF	DEZENA,W	; MOVE CONTEÚDO DE DEZENA PARA W
	CALL	CONVERTE	; CHAMA ROTINA DE CONVERSÃO
	MOVWF	BUS		; MOVE DADO PARA O BARRAMENTO
	BSF	SEL_DEZENA	; SELECIONA O DISPLAY DE DEZENA
	GOTO	SAI_INTERRUPCAO	; SAI DA INTERRUPÇÃO
	
DISPLAY_UNIDADE
	
	BCF	SEL_DEZENA	; DESLIGA SELEÇÃO DE DEZENA
			
	MOVF	UNIDADE,W	; MOVE CONTEÚDO DE DEZENA PARA W
	CALL	CONVERTE	; CHAMA ROTINA DE CONVERSÃO
	MOVWF	BUS		; MOVE DADO PARA O BARRAMENTO
	BSF	SEL_UNIDADE	; SELECIONA O DISPLAY DE UNIDADE
	GOTO	SAI_INTERRUPCAO	; SAI DA INTERRUPÇÃO

;*	*	*	*	*	*	*	*	*	*
;*     	            TRATATAMENTO DE INTERRUPÇÃO DE TIMER1		*
;*	*	*	*	*	*	*	*	*	*

TRATA_TIMER1
	
	BCF	PIR1,TMR1IF	; LIMPA FLAG DE INTERRUPÇÃO
	
	MOVLW	TMR1_L		; RECARREGA BASE DE TEMPO	
	ADDWF	TMR1L
	BTFSC	STATUS,C
	INCF	TMR1H,F
	
	MOVLW	TMR1_H
	ADDWF	TMR1H
	
	BTFSC	PISCA		; PISCA ESTÁ APAGADO?
	GOTO	$+3		; NÃO, ENTÃO APAGA
	BSF	PISCA		; SIM, ENTÃO ACENDE
	GOTO	$+2		; SALTA DUAS POSIÇÕES
	BCF	PISCA		; APGA O PISCA
	
	DECFSZ	VEZES_TMR1,F	; DECREMENTA VARIÁVEL, CHEGOU A ZERO?
	GOTO	SAI_INTERRUPCAO	; NÃO, ENTÃO SAI DA INTERRUPÇÃO
	
	MOVLW	.120		; CARREGA VEZES_TMR1 COM 120
	MOVWF	VEZES_TMR1	; PARA CONTAR 1 SEGUNDO
	
	INCF	UNIDADE,F	; INCREMENTA A UNIDADE	
	MOVLW	.10		; MOVE 10 PARA W	
	XORWF	UNIDADE,W	; COMPARA COM VARIÁVEL
	BTFSS	STATUS,Z	; VARIÁVEL CHEGOU A 10?
	GOTO	SAI_INTERRUPCAO	; NÃO, ENTÃO RETORNA DA INTERRUPÇÃO
	CLRF	UNIDADE		; SIM, ENTÃO LIMPA A UNIDADE
	
	INCF	DEZENA,F	; INCREMENTA A DEZENA	
	MOVLW	.6		; MOVE 6 DECIMAL PARA W
	XORWF	DEZENA,W	; COMPARA COM VARIÁVEL	
	BTFSS	STATUS,Z	; CHEGOU A 6?
	GOTO	SAI_INTERRUPCAO	; NÃO, ENTÃO SAI DA INTERRUPÇÃO
	CLRF	DEZENA		; SIM, LIMPA VARIÁVEL DE DEZENA
	
	INCF	CENTENA,F	; INCREMENTA VARIÁVEL DE CENTENA
	MOVLW	.10		; MOVE 10 DECIMAL PARA W
	XORWF	CENTENA,W	; COMPARA COM VARIÁVEL
	BTFSS	STATUS,Z	; CHEGOU A 10?
	GOTO	VERIFICA_HORA	; NÃO, ENTÃO SALTA PARA VERIFICAR A HORA
	CLRF	CENTENA		; SIM, LIMPA VARIÁVEL DE CENTENA
	INCF	MILHAR,F	; INCREMENTA A VARIÁVEL DE MILHAR
	GOTO	SAI_INTERRUPCAO	; SAI DA INTERRUPÇÃO
	
VERIFICA_HORA
	
	MOVLW	.2		; MOVE 2 PARA W
	XORWF	MILHAR,W	; COMPARA COM VARIÁVEL
	BTFSS	STATUS,Z	; CHEGOU A 2?
	GOTO	SAI_INTERRUPCAO	; NÃO, ENTÃO SAI DA INTERRUPÇÃO

	MOVLW	.4		; MOVE 4 PARA W
	XORWF	CENTENA,W	; COMPARA COM VARIÁVEL
	BTFSS	STATUS,Z	; CHEGOU A 4?
	GOTO	SAI_INTERRUPCAO	; NÃO, ENTÃO SAI DA INTERRUPÇÃO
	
	CLRF	CENTENA		; SIM, ENTÃO LIMPA VARIÁVEL DE CENTENA
	CLRF	MILHAR		; LIMPA VARIÁVEL DE MILHAR
	GOTO	SAI_INTERRUPCAO	; SAI DA INTERRUPÇÃO

;*	*	*	*	*	*	*	*	*	*
;*	            ROTINA DE CONVERSÃO BCD -> 7 SEGMENTOS		*
;*	*	*	*	*	*	*	*	*	*

CONVERTE
	
	MOVWF	TEMP_INT	; SALVA W EM VARIÁVEL
	
	MOVLW	HIGH SALTO_CONVERTE  ; MOVE A PARTE ALTA DO ENDEREÇO PARA W
	MOVWF	PCLATH		; MOVE W PARA PCLATH   	
	
	MOVLW	LOW SALTO_CONVERTE   ; MOVE PARTE BAIXA DO ENDEREÇO PARA W	
	ADDWF	TEMP_INT,W	; ADICIONA COM VALOR DE TEMP_INT     	
	BTFSC	STATUS,C	; HOUVE ESTOURO?	
	INCF	PCLATH,F	; SIM, ENTÃO INCREMENTA PCLATH
	MOVWF	PCL		; MOVE W PARA PCL

SALTO_CONVERTE
	
		 ;PGFEDCBA	; POSIÇÃO DOS SEGUIMENTOS
	RETLW	B'00111111'	; RETORNA CARACTERE 0
	RETLW	B'00000110'	; RETORNA CARACTERE 1
	RETLW	B'01011011'	; RETORNA CARACTERE 2
	RETLW	B'01001111'	; RETORNA CARACTERE 3
	RETLW	B'01100110'	; RETORNA CARACTERE 4
	RETLW	B'01101101'	; RETORNA CARACTERE 5
	RETLW	B'01111101'	; RETORNA CARACTERE 6
	RETLW	B'00000111'	; RETORNA CARACTERE 7
	RETLW	B'01111111'	; RETORNA CARACTERE 8
	RETLW	B'01101111'	; RETORNA CARACTERE 9
	RETLW	B'01110111'	; RETORNA CARACTERE A
	RETLW	B'01111100'	; RETORNA CARACTERE B
	RETLW	B'00111001'	; RETORNA CARACTERE C
	RETLW	B'01011110'	; RETORNA CARACTERE D
	RETLW	B'01111001'	; RETORNA CARACTERE E
	RETLW	B'01110001'	; RETORNA CARACTERE F
	
;*	*	*	*	*	*	*	*	*	*
;*		          CONFIGURACOES INICIAIS			*
;*	*	*	*	*	*	*	*	*	*

CONFIG_

	CLRF	PORTA		; LIMPA O PORTA
	CLRF	PORTB		; LIMPA O PORTB
	CLRF	PORTC		; LIMPA O PORTC
	CLRF	PORTD		; LIMPA O PORTD
	CLRF	PORTE		; LIMPA O PORTE
	
	BANK1			; SELECIONA BANCO1 DE MEMÓRIA

	MOVLW	B'11000000'
	MOVWF	TRISB		; CONFIGURA I/O DO PORTB
	
	MOVLW	B'00000000'	; CONFIGURA TODOS OS PINOS DESTE
	MOVWF	TRISD		; PORTB COMO SAÍDA
	
	MOVLW	B'10001111'	; DESLIGA PULL-UPS
	MOVWF	OPTION_REG	; WDT 1:128
	
	MOVLW	B'00000001'
	MOVWF	PIE1		; HABILITA INTERRUPÇÃO DE TIMER1
	
	MOVLW	B'01100000'	; HABILITA INTERRUPÇÃO DOS PERIFÉRICOS
	MOVWF	INTCON		; HABILITA INTERRUPÇÃO DE TIMER 0
	
	BANK0
	
	BTFSC	STATUS,NOT_TO	; ESTOURO POR WDT?
	GOTO	$		; NÃO, ENTÃO AGUARDA
	
LIMPEZA_DA_RAM
				; ROTINA DE LIMPEZA DA RAM
				
	MOVLW	0x20
	MOVWF	FSR
	CLRF	INDF
	INCF	FSR,F
	MOVLW	0x80
	XORWF	FSR,W
	BTFSS	STATUS,Z
	GOTO	$-5
						
;*	*	*	*	*	*	*	*	*	*
;*         	         INICIALIZAÇÃO DAS VARIÁVEIS			*
;*	*	*	*	*	*	*	*	*	*

	MOVLW	TMR1_H		; CARREGA CONSTANTES
	MOVWF	TMR1H		; DE BASE DE TEMPO
	MOVLW	TMR1_L	
	MOVWF	TMR1L
	MOVLW	B'00110001'	; PRESCALER 1:8
	MOVWF	T1CON		; TIMER1 -> ON	
	
	MOVLW	.120
	MOVWF	VEZES_TMR1	; VALOR INICIAL PARA CONTAR 1s
	
	BSF	INTCON,GIE	; LIGA AS INTERRUPÇÕES
	
;*	*	*	*	*	*	*	*	*	*
;*		            ROTINA PRINCIPAL				*
;*	*	*	*	*	*	*	*	*	*

LOOP
	CLRWDT			; LIMPA O WATCHDOG
	GOTO	LOOP		; SALTA PARA O LOOP PRINCIPAL
		
;*	*	*	*	*	*	*	*	*	*
;*		             FIM DO PROGRAMA				*
;*	*	*	*	*	*	*	*	*	*


	END			; FIM DO PROGRAMA


