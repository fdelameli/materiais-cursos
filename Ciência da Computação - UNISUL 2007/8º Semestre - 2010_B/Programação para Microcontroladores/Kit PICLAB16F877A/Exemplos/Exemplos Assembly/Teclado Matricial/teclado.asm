;*	*	*	*	*	*	*	*	*	*
;*			  Programação em Assembly			*
;* 	        EXEMPLO2: UTILIZANDO O TECLADO MATRICIAL		*
;*		     APOSTILA MÓDULO B  -  PIC16F877A			*
;*		      CERNE TECNOLOGIA E TREINAMENTO			*
;*	    VERSÃO 1.0				DATA:03/05/2005		*
;*									*
;*	*	*	*	*	*	*	*	*	*

;*	*	*	*	*	*	*	*	*	*
;*			 OBJETIVO DO ARQUIVO FONTE			*
;*									*
;*	     DEMONSTRAR A UTILIZAÇÃO DE UM TECLADO MATRICIAL		*
;*									*
;*	*	*	*	*	*	*	*	*	*

 #INCLUDE <P16F877.INC> 	;ARQUIVO PADRÃO PARA PIC16F877A
 __CONFIG _CP_OFF & _XT_OSC & _PWRTE_ON & _LVP_OFF & _WDT_ON & _BODEN_OFF & _CPD_OFF & _DEBUG_OFF
 	
 	;NESTE PONTO É INFORMADO A CONFIGURAÇÃO DA MÁQUINA, OU SEJA, SE TERÁ
 	;CÓDIGO DE PROTEÇÃO OU O TIPO DE CRISTAL QUE SERÁ UTILIZADO	

 	;CONFIGURAÇÃO DA MÁQUINA
 	; CODE PROTECT		        -> DESLIGADO
 	; OSCILADOR    		        -> CRISTAL OU RESSONADOR
 	; POWER-UP     		        -> LIGADO
 	; DEBUF 		        -> DESLIGADO		
 	; PROGRAMAÇÃO EM BAIXA VOLTAGEM -> DESLIGADO
	; WATCH DOG			-> LIGADO
	; BROWN-OUT RESET		-> DESLIGADO
	; PROTEÇÃO DE EEPROM		-> DESLIGADO
	 	
;*	*	*	*	*	*	*	*	*	*
;*			   PAGINAÇÃO DE MEMÓRIA				*
;*	*	*	*	*	*	*	*	*	*

; AQUI CRIAREMOS UM PSEUDÔNIMO PARA UM COMANDO. POR EXEMPLO, O COMANDO
; "BCF STATUS,RP0" PODE SER SUBSTITUÍDO SEM PROBLEMAS POR "BANK0". O 
; COMPILADOR IRÁ SUBSTITUIR INTERNAMENTE "BANK0" POR "BCF STATUS,RP0".
; ESTA APLICAÇÃO É VÁLIDA PARA OUTROS TIPOS DE COMANDOS

#DEFINE	BANK0	BCF	STATUS,RP0	; ESCOLHE BANCO DE MEMÓRIA 0
#DEFINE	BANK1	BSF	STATUS,RP0	; ESCOLHE BANCO DE MEMÓRIA 1

;*	*	*	*	*	*	*	*	*	*
;*			     DEFINICAO DE RAM				*
;*	*	*	*	*	*	*	*	*	*

; AQUI IREMOS CRIAR AS VARIÁVEIS DO NOSSO SISTEMA

	CBLOCK 0x20	; INÍCIO DO BLOCO DE RAM(GPR)
		MILHAR	; REGISTRADOR DO MILHAR
		CENTENA	; REGISTRADOR DA CENTENA
		DEZENA	; REGISTRADOR DA DEZENA
		UNIDADE	; REGISTRADOR DA UNIDADE
		INDICE_DISPLAY ; INDICE PARA O DISPLAY
		TEMP_INT       ; VARIÁVEL DE USO GERAL DA INTERRUPÇÃO
		VEZES_TMR1     ; VARIÁVEL PARA CONTAR 1s 	
		FLAGS	       ; VARIÁVEL DE FLAGS DO SISTEMA	
		TECLADO1       ; VARIÁVEL DO TECLADO DO SISTEMA
		TECLADO2       ; VARIÁVEL DO TECLADO DO SISTEMA
		TEMPO1
		TEMPO2
	ENDC		; FIM DO BLOCO DE RAM(GPR)
	
	CBLOCK 0x70	; INÍCIO DO BLOCO DE RAM ESPELHADO(GPR)
		W_TEMP		; REGISTRADORES TEMPORÁRIOS
		STATUS_TEMP
		FSR_TEMP
		PCLATH_TEMP
	ENDC		; FIM DO BLOCO DE RAM ESPELHADO(GPR)
	
;*	*	*	*	*	*	*	*	*	*
;*		          DEFINICAO DE FLAGS				*
;*	*	*	*	*	*	*	*	*	*

; AQUI SÃO DEFINIDOS OS FLAGS QUE SERÃO UTILIZADOS PELO SISTEMA
	
#DEFINE	 PISCA		FLAGS,0	; DEFINE FLAG PARA PISCAR O DISPLAY

#DEFINE  TECLA_0	TECLADO1,0  ; TECLA 0 DO TECLADO MATRICIAL
#DEFINE  TECLA_1	TECLADO1,1  ; TECLA 1 DO TECLADO MATRICIAL	
#DEFINE  TECLA_2	TECLADO1,2  ; TECLA 2 DO TECLADO MATRICIAL	
#DEFINE  TECLA_3	TECLADO1,3  ; TECLA 3 DO TECLADO MATRICIAL
#DEFINE  TECLA_4	TECLADO1,4  ; TECLA 4 DO TECLADO MATRICIAL
#DEFINE  TECLA_5	TECLADO1,5  ; TECLA 5 DO TECLADO MATRICIAL
#DEFINE  TECLA_6	TECLADO1,6  ; TECLA 6 DO TECLADO MATRICIAL
#DEFINE  TECLA_7	TECLADO1,7  ; TECLA 7 DO TECLADO MATRICIAL
#DEFINE  TECLA_8	TECLADO2,0  ; TECLA 8 DO TECLADO MATRICIAL
#DEFINE  TECLA_9	TECLADO2,1  ; TECLA 9 DO TECLADO MATRICIAL
#DEFINE  TECLA_C	TECLADO2,2  ; TECLA CORRIGE DO TECLADO MATRICIAL
#DEFINE  TECLA_E	TECLADO2,3  ; TECLA ENTER DO TECLADO MATRICIAL

;*	*	*	*	*	*	*	*	*	*
;*		        DEFINICAO DE CONSTANTES				*
;*	*	*	*	*	*	*	*	*	*

; AQUI SÃO DEFINIDOS AS CONSTANTES QUE SERÃO UTILIZADOS PELO SISTEMA

#DEFINE SEL_LINHA1	B'00001110'  ; SELECIONA LINHA 1	
#DEFINE SEL_LINHA2	B'00001101'  ; SELECIONA LINHA 2		
#DEFINE SEL_LINHA3	B'00001011'  ; SELECIONA LINHA 3		
#DEFINE SEL_LINHA4	B'00000111'  ; SELECIONA LINHA 4	

#DEFINE TEMPO_BEEP	.10	     ; TEMPO DE BEEP LIGADO, 10 ms

#DEFINE CARACTER_0	H'00'	     ; DEFINE CARACTER 0	
#DEFINE CARACTER_1	H'01'	     ; DEFINE CARACTER 1		
#DEFINE CARACTER_2	H'02'	     ; DEFINE CARACTER 2		
#DEFINE CARACTER_3	H'03'	     ; DEFINE CARACTER 3	 
#DEFINE CARACTER_4	H'04'	     ; DEFINE CARACTER 4		 
#DEFINE CARACTER_5	H'05'	     ; DEFINE CARACTER 5	
#DEFINE CARACTER_6	H'06'	     ; DEFINE CARACTER 6		
#DEFINE CARACTER_7	H'07'	     ; DEFINE CARACTER 7		
#DEFINE CARACTER_8	H'08'	     ; DEFINE CARACTER 8	
#DEFINE CARACTER_9	H'09'	     ; DEFINE CARACTER 9		
#DEFINE CARACTER_A	H'0A'	     ; DEFINE CARACTER A	
#DEFINE CARACTER_B	H'0B'	     ; DEFINE CARACTER B		
#DEFINE CARACTER_C	H'0C'	     ; DEFINE CARACTER C		 
#DEFINE CARACTER_D	H'0D'	     ; DEFINE CARACTER D		
#DEFINE CARACTER_E	H'0E'	     ; DEFINE CARACTER E		
#DEFINE CARACTER_F	H'0F'	     ; DEFINE CARACTER F		

;*	*	*	*	*	*	*	*	*	*
;*			  ENTRADAS DO SISTEMA				*
;*	*	*	*	*	*	*	*	*	*

#DEFINE COL1		PORTA,4	     ; PINO DE ENTRADA DA COLUNA1	
#DEFINE COL2		PORTA,5	     ; PINO DE ENTRADA DA COLUNA2		
#DEFINE COL3		PORTE,0	     ; PINO DE ENTRADA DA COLUNA3		

;*	*	*	*	*	*	*	*	*	*
;*			  SAIDAS DO SISTEMA				*
;*	*	*	*	*	*	*	*	*	*

; AQUI SÃO DEFINIDAS AS SAÍDAS QUE SERÃO UTILIZADOS PELO SISTEMA

#DEFINE BUS		PORTD	; DEFINE O BARRAMENTO COMO O PORTD 
#DEFINE SEL_UNIDADE	PORTB,4	; SELECIONA DISPLAY DA UNIDADE DE MILHAR
#DEFINE SEL_DEZENA	PORTB,3	; SELECIONA DISPLAY DA CENTENA
#DEFINE SEL_CENTENA	PORTB,2	; SELECIONA DISPLAY DA DEZENA
#DEFINE SEL_MILHAR	PORTB,1	; SELECIONA DISPLAY DA UNIDADE
#DEFINE BEEP		PORTC,5	; SAÍDA DO BEEP

;*	*	*	*	*	*	*	*	*	*
;*			    VETOR DE RESET				*
;*	*	*	*	*	*	*	*	*	*

	ORG 	0x0000		; ENDEREÇO INICIAL DA MÁQUINA
	GOTO	CONFIG_		; SALTA PARA CONFIGURAR A MÁQUINA

;*	*	*	*	*	*	*	*	*	*
;*		         VETOR DE INTERRUPÇÃO				*
;*	*	*	*	*	*	*	*	*	*

	ORG 	0x0004		; ENDEREÇO INICIAL DO VETOR DE INTERRUPÇÃO
SALVA_CONTEXTO
	MOVWF	W_TEMP		; SALVA W
	SWAPF	STATUS,W	
	MOVWF	STATUS_TEMP	; SALVA STATUS
	MOVF	FSR,W
	MOVWF	FSR_TEMP	; SALVA FSR	
	MOVF	PCLATH,W	
	MOVWF	PCLATH_TEMP	; SALVA PCLATH
	
	CLRF	STATUS		; GARANTE BANCO 0
	CLRF	PCLATH		; GARANTE PÁGINA 0
	
	BTFSC	INTCON,T0IF	; INTERRUPÇÃO DE TIMER0?
	GOTO	TRATA_TIMER0	; SIM, ENTÃO TRATA
	
SAI_INTERRUPCAO	
	MOVF	FSR_TEMP,W
	MOVWF	FSR		; RECUPERA FSR
	MOVF	PCLATH_TEMP,W	
	MOVWF	PCLATH		; RECUPERA PCLATH
	SWAPF	STATUS_TEMP,W
	MOVWF	STATUS		; RECUPERA STATUS
	SWAPF	W_TEMP,F
	SWAPF	W_TEMP,W	; RECUPERA W
	RETFIE			; RETORNA DA INTERRUPÇÃO

;*	*	*	*	*	*	*	*	*	*
;*     	            TRATATAMENTO DE INTERRUPÇÃO DE TIMER0		*
;*	*	*	*	*	*	*	*	*	*

TRATA_TIMER0
	
	BCF	INTCON,T0IF	 ; LIMPA FLAG DE INTERRUPÇÃO
	INCF	INDICE_DISPLAY,F ; INCREMENTA INDICE DOS DISPLAYS
	MOVLW	B'00000011'	 
	ANDWF	INDICE_DISPLAY,W ; MASCARA OS BITS SUPERIORES	
	ADDWF	PCL,F	 	 ; SOMA CONTEÚDO COM PCL	
	GOTO	DISPLAY_MILHAR	 ; MOSTRA DISPLAY DE MILHAR
	GOTO	DISPLAY_CENTENA	 ; MOSTRA DISPLAY DE CENTENA
	GOTO	DISPLAY_DEZENA   ; MOSTRA DISPLAY DE DEZENA
	GOTO	DISPLAY_UNIDADE  ; MOSTRA DISPLAY DE UNIDADE
	
DISPLAY_MILHAR
	
	BCF	SEL_UNIDADE	; RETIRA SELEÇÃO DA UNIDADE
	CALL	VERIFICA_LINHA1 ; CHAMA ROTINA PARA VERIFICAR A LINHA 1
	
	MOVF	MILHAR,W	; MOVE CONTEÚDO DE MILHAR PARA W
	CALL	CONVERTE	; CHAMA ROTINA DE CONVERSÃO
	MOVWF	BUS		; MOVE DADO PARA O BARRAMENTO
	BSF	SEL_MILHAR	; SELECIONA O DISPLAY DE MILHAR
	GOTO	SAI_INTERRUPCAO	; SAI DA INTERRUPÇÃO
	

DISPLAY_CENTENA
	
	BCF	SEL_MILHAR	; RETIRA SELEÇÃO DO MILHAR
	CALL	VERIFICA_LINHA2 ; CHAMA ROTINA PARA VERIFICAR A LINHA 2
	
	MOVF	CENTENA,W	; MOVE CONTEÚDO DE CENTENA PARA W
	CALL	CONVERTE	; CHAMA ROTINA DE CONVERSÃO
	MOVWF	BUS		; MOVE DADO PARA O BARRAMENTO
	BSF	SEL_CENTENA	; SELECIONA O DISPLAY DE CENTENA
	GOTO	SAI_INTERRUPCAO	; SAI DA INTERRUPÇÃO
			
DISPLAY_DEZENA
	
	BCF	SEL_CENTENA	; RETIRA SELEÇÃO DA CENTENA
	CALL	VERIFICA_LINHA3 ; CHAMA ROTINA PARA VERIFICAR A LINHA 3
	
	MOVF	DEZENA,W	; MOVE CONTEÚDO DE DEZENA PARA W
	CALL	CONVERTE	; CHAMA ROTINA DE CONVERSÃO
	MOVWF	BUS		; MOVE DADO PARA O BARRAMENTO
	BSF	SEL_DEZENA	; SELECIONA O DISPLAY DE DEZENA
	GOTO	SAI_INTERRUPCAO	; SAI DA INTERRUPÇÃO
	
DISPLAY_UNIDADE
	
	BCF	SEL_DEZENA	; RETIRA SELEÇÃO DA DEZENA
	CALL	VERIFICA_LINHA4 ; CHAMA ROTINA PARA VERIFICAR A LINHA 4
	
	MOVF	UNIDADE,W	; MOVE CONTEÚDO DE DEZENA PARA W
	CALL	CONVERTE	; CHAMA ROTINA DE CONVERSÃO
	MOVWF	BUS		; MOVE DADO PARA O BARRAMENTO
	BSF	SEL_UNIDADE	; SELECIONA O DISPLAY DE UNIDADE
	GOTO	SAI_INTERRUPCAO	; SAI DA INTERRUPÇÃO

VERIFICA_LINHA1
	
	MOVLW	SEL_LINHA1	
	MOVWF	BUS		; SELECIONA A LINHA 1	
	
	BCF	TECLA_1		; LIMPA FLAG DA TECLA 1 PRESSIONADA
	BCF	TECLA_2		; LIMPA FLAG DA TECLA 2 PRESSIONADA
	BCF	TECLA_3		; LIMPA FLAG DA TECLA 3 PRESSIONADA
		
	BTFSS	COL1		; COLUNA1 ESTÁ PRESSIONADA?
	BSF	TECLA_1		; SIM, ENTÃO SETA TECLA_1
	
	BTFSS	COL2		; COLUNA2 ESTÁ PRESSIONADA?
	BSF	TECLA_2		; SIM, ENTÃO SETA TECLA_2
	
	BTFSS	COL3		; COLUNA3 ESTÁ PRESSIONADA?
	BSF	TECLA_3		; SIM, ENTÃO SETA TECLA_3
	
	RETURN			; RETORNA DA INTERRUPÇÃO
	
VERIFICA_LINHA2
	
	MOVLW	SEL_LINHA2
	MOVWF	BUS		; SELECIONA A LINHA 2	
	
	BCF	TECLA_4		; LIMPA FLAG DA TECLA 4 PRESSIONADA
	BCF	TECLA_5		; LIMPA FLAG DA TECLA 5 PRESSIONADA
	BCF	TECLA_6		; LIMPA FLAG DA TECLA 6 PRESSIONADA
		
	BTFSS	COL1		; COLUNA1 ESTÁ PRESSIONADA?
	BSF	TECLA_4		; SIM, ENTÃO SETA TECLA_4
	
	BTFSS	COL2		; COLUNA2 ESTÁ PRESSIONADA?
	BSF	TECLA_5		; SIM, ENTÃO SETA TECLA_5
	
	BTFSS	COL3		; COLUNA3 ESTÁ PRESSIONADA?
	BSF	TECLA_6		; SIM, ENTÃO SETA TECLA_6
	
	RETURN			; RETORNA DA INTERRUPÇÃO

VERIFICA_LINHA3
	
	MOVLW	SEL_LINHA3
	MOVWF	BUS		; SELECIONA A LINHA 3	
	
	BCF	TECLA_7		; LIMPA FLAG DA TECLA 7 PRESSIONADA
	BCF	TECLA_8		; LIMPA FLAG DA TECLA 8 PRESSIONADA
	BCF	TECLA_9		; LIMPA FLAG DA TECLA 9 PRESSIONADA
		
	BTFSS	COL1		; COLUNA1 ESTÁ PRESSIONADA?
	BSF	TECLA_7		; SIM, ENTÃO SETA TECLA_7
	
	BTFSS	COL2		; COLUNA2 ESTÁ PRESSIONADA?
	BSF	TECLA_8		; SIM, ENTÃO SETA TECLA_8
	
	BTFSS	COL3		; COLUNA3 ESTÁ PRESSIONADA?
	BSF	TECLA_9		; SIM, ENTÃO SETA TECLA_9
	
	RETURN			; RETORNA DA INTERRUPÇÃO

VERIFICA_LINHA4
	
	MOVLW	SEL_LINHA4	
	MOVWF	BUS		; SELECIONA A LINHA 4	
	
	BCF	TECLA_E		; LIMPA FLAG DA TECLA ENTER PRESSIONADA
	BCF	TECLA_C		; LIMPA FLAG DA TECLA CORRIGE PRESSIONADA
	BCF	TECLA_0		; LIMPA FLAG DA TECLA 0 PRESSIONADA
		
	BTFSS	COL1		; COLUNA1 ESTÁ PRESSIONADA?
	BSF	TECLA_C		; SIM, ENTÃO SETA TECLA_C
	
	BTFSS	COL2		; COLUNA2 ESTÁ PRESSIONADA?
	BSF	TECLA_0		; SIM, ENTÃO SETA TECLA_0
	
	BTFSS	COL3		; COLUNA3 ESTÁ PRESSIONADA?
	BSF	TECLA_E		; SIM, ENTÃO SETA TECLA_E
	
	RETURN			; RETORNA DA INTERRUPÇÃO

;*	*	*	*	*	*	*	*	*	*
;*	            ROTINA DE CONVERSÃO BCD -> 7 SEGMENTOS		*
;*	*	*	*	*	*	*	*	*	*

CONVERTE
	
	MOVWF	TEMP_INT	; SALVA W EM VARIÁVEL
	
	MOVLW	HIGH SALTO_CONVERTE  ; MOVE A PARTE ALTA DO ENDEREÇO PARA W
	MOVWF	PCLATH		; MOVE W PARA PCLATH   	
	
	MOVLW	LOW SALTO_CONVERTE   ; MOVE PARTE BAIXA DO ENDEREÇO PARA W	
	ADDWF	TEMP_INT,W	; ADICIONA COM VALOR DE TEMP_INT     	
	BTFSC	STATUS,C	; HOUVE ESTOURO?	
	INCF	PCLATH,F	; SIM, ENTÃO INCREMENTA PCLATH
	MOVWF	PCL		; MOVE W PARA PCL

SALTO_CONVERTE
	
		 ;PGFEDCBA	; POSIÇÃO DOS SEGUIMENTOS
	RETLW	B'00111111'	; RETORNA CARACTERE 0
	RETLW	B'00000110'	; RETORNA CARACTERE 1
	RETLW	B'01011011'	; RETORNA CARACTERE 2
	RETLW	B'01001111'	; RETORNA CARACTERE 3
	RETLW	B'01100110'	; RETORNA CARACTERE 4
	RETLW	B'01101101'	; RETORNA CARACTERE 5
	RETLW	B'01111101'	; RETORNA CARACTERE 6
	RETLW	B'00000111'	; RETORNA CARACTERE 7
	RETLW	B'01111111'	; RETORNA CARACTERE 8
	RETLW	B'01101111'	; RETORNA CARACTERE 9
	RETLW	B'01110111'	; RETORNA CARACTERE A
	RETLW	B'01111100'	; RETORNA CARACTERE B
	RETLW	B'00111001'	; RETORNA CARACTERE C
	RETLW	B'01011110'	; RETORNA CARACTERE D
	RETLW	B'01111001'	; RETORNA CARACTERE E
	RETLW	B'01110001'	; RETORNA CARACTERE F

;*	*	*	*	*	*	*	*	*	*
;*                       ROTINA PARA TOCAR O BEEP			*
;*	*	*	*	*	*	*	*	*	*

TOCA_BEEP

	BSF	BEEP		; LIGA O BEEP
	MOVLW	TEMPO_BEEP
	CALL	DELAY		; CHAMA ROTINA DE DELAY
	BCF	BEEP		; DESLIGA O BEEP
	RETURN			; RETORNA DA INTERRUPÇÃO
		
;*	*	*	*	*	*	*	*	*	*
;*	              ROTINA DE DELAY DE 1ms A 256ms			*
;*	*	*	*	*	*	*	*	*	*

DELAY
	
	MOVWF	TEMPO2
	
	CLRF	TEMPO1		; LIMPA REGISTRADOR

DELAY_A
	
	NOP			; PERDE 1 CICLO DE MÁQUINA
	DECFSZ	TEMPO1,F	; DECREMENTA REGISTRADOR, ACABOU?
	GOTO	$-2		; NÃO, ENTÃO RETORNA DUAS POSIÇÕES 
	DECFSZ	TEMPO2,F
	GOTO	DELAY_A
	
	RETURN			; RETORNA DA INTERRUPÇÃO

;*	*	*	*	*	*	*	*	*	*
;*		          CONFIGURACOES INICIAIS			*
;*	*	*	*	*	*	*	*	*	*

CONFIG_

	CLRF	PORTA		; LIMPA O PORTA
	CLRF	PORTB		; LIMPA O PORTB
	CLRF	PORTC		; LIMPA O PORTC
	CLRF	PORTD		; LIMPA O PORTD
	CLRF	PORTE		; LIMPA O PORTE
	
	BANK1			; SELECIONA BANCO1 DE MEMÓRIA
	
	MOVLW	B'11111111'
	MOVWF	TRISA		; COLOCA OS PINOS DO PORTA COMO ENTRADAS
	
	MOVLW	B'11000000'
	MOVWF	TRISB		; CONFIGURA I/O DO PORTB
	
	MOVLW	B'11011111'
	MOVWF	TRISC		; CONFIGURA I/O DO PORTC
	
	MOVLW	B'00000000'	; CONFIGURA TODOS OS PINOS DESTE
	MOVWF	TRISD		; PORTB COMO SAÍDA
	
	MOVLW	B'00000111'
	MOVWF	TRISE		; CONFIGURA I/O DO PORTE
	
	MOVLW	B'10001111'	; DESLIGA PULL-UPS
	MOVWF	OPTION_REG	; WDT 1:128
	
	MOVLW	B'00100000'	; HABILITA INTERRUPÇÃO DOS PERIFÉRICOS
	MOVWF	INTCON		; HABILITA INTERRUPÇÃO DE TIMER 0
	
	MOVLW	B'00000111'
	MOVWF	ADCON1		; DESLIGA OS A/D'S
	
	BANK0
	
	BTFSC	STATUS,NOT_TO	; ESTOURO POR WDT?
	GOTO	$		; NÃO, ENTÃO AGUARDA
	
LIMPEZA_DA_RAM
				; ROTINA DE LIMPEZA DA RAM
				
	MOVLW	0x20
	MOVWF	FSR
	CLRF	INDF
	INCF	FSR,F
	MOVLW	0x80
	XORWF	FSR,W
	BTFSS	STATUS,Z
	GOTO	$-5
						
;*	*	*	*	*	*	*	*	*	*
;*         	         INICIALIZAÇÃO DAS VARIÁVEIS			*
;*	*	*	*	*	*	*	*	*	*

	BSF	INTCON,GIE	; LIGA AS INTERRUPÇÕES
	
;*	*	*	*	*	*	*	*	*	*
;*		            ROTINA PRINCIPAL				*
;*	*	*	*	*	*	*	*	*	*

LOOP
	CLRWDT			; LIMPA O WATCHDOG
	
	BTFSS	TECLA_1		; TECLA 1 ESTÁ PRESSIONADA?
	GOTO	$+4		; NÃO, ENTÃO SALTA 4 POSIÇÕES DE MEMÓRIA
	MOVLW	CARACTER_1	; SIM, ENTÃO MOVE O CARACTER 1 PARA W
	MOVWF	MILHAR		; MOVE O DADO PARA A VARIÁVEL DE MILHAR
	CALL	TOCA_BEEP	; CHAMA ROTINA PARA TOCAR O BEEP
	
	BTFSS	TECLA_2		; TECLA 2 ESTÁ PRESSIONADA?
	GOTO	$+4		; NÃO, ENTÃO SALTA 4 POSIÇÕES DE MEMÓRIA
	MOVLW	CARACTER_2	; SIM, ENTÃO MOVE O CARACTER 2 PARA W
	MOVWF	MILHAR		; MOVE O DADO PARA A VARIÁVEL DE MILHAR
	CALL	TOCA_BEEP	; CHAMA ROTINA PARA TOCAR O BEEP
		
	BTFSS	TECLA_3		; TECLA 3 ESTÁ PRESSIONADA?
	GOTO	$+4		; NÃO, ENTÃO SALTA 4 POSIÇÕES DE MEMÓRIA
	MOVLW	CARACTER_3	; SIM, ENTÃO MOVE O CARACTER 3 PARA W	
	MOVWF	MILHAR		; MOVE O DADO PARA A VARIÁVEL DE MILHAR
	CALL	TOCA_BEEP	; CHAMA ROTINA PARA TOCAR O BEEP
		
	BTFSS	TECLA_4		; TECLA 4 ESTÁ PRESSIONADA?
	GOTO	$+4		; NÃO, ENTÃO SALTA 4 POSIÇÕES DE MEMÓRIA
	MOVLW	CARACTER_4	; SIM, ENTÃO MOVE O CARACTER 4 PARA W
	MOVWF	CENTENA		; MOVE O DADO PARA A VARIÁVEL DE MILHAR
	CALL	TOCA_BEEP	; CHAMA ROTINA PARA TOCAR O BEEP
	
	BTFSS	TECLA_5		; TECLA 5 ESTÁ PRESSIONADA?
	GOTO	$+4		; NÃO, ENTÃO SALTA 4 POSIÇÕES DE MEMÓRIA
	MOVLW	CARACTER_5	; SIM, ENTÃO MOVE O CARACTER 5 PARA W	
	MOVWF	CENTENA		; MOVE O DADO PARA A VARIÁVEL DE MILHAR
	CALL	TOCA_BEEP	; CHAMA ROTINA PARA TOCAR O BEEP
			
	BTFSS	TECLA_6		; TECLA 6 ESTÁ PRESSIONADA?
	GOTO	$+4		; NÃO, ENTÃO SALTA 4 POSIÇÕES DE MEMÓRIA
	MOVLW	CARACTER_6	; SIM, ENTÃO MOVE O CARACTER 6 PARA W	
	MOVWF	CENTENA		; MOVE O DADO PARA A VARIÁVEL DE MILHAR
	CALL	TOCA_BEEP	; CHAMA ROTINA PARA TOCAR O BEEP
		
	BTFSS	TECLA_7		; TECLA 7 ESTÁ PRESSIONADA?
	GOTO	$+4		; NÃO, ENTÃO SALTA 4 POSIÇÕES DE MEMÓRIA
	MOVLW	CARACTER_7	; SIM, ENTÃO MOVE O CARACTER 7 PARA W
	MOVWF	DEZENA		; MOVE O DADO PARA A VARIÁVEL DE MILHAR
	CALL	TOCA_BEEP	; CHAMA ROTINA PARA TOCAR O BEEP
			
	BTFSS	TECLA_8		; TECLA 8 ESTÁ PRESSIONADA?
	GOTO	$+4		; NÃO, ENTÃO SALTA 4 POSIÇÕES DE MEMÓRIA
	MOVLW	CARACTER_8	; SIM, ENTÃO MOVE O CARACTER 8 PARA W
	MOVWF	DEZENA		; MOVE O DADO PARA A VARIÁVEL DE MILHAR
	CALL	TOCA_BEEP	; CHAMA ROTINA PARA TOCAR O BEEP
		
	BTFSS	TECLA_9		; TECLA 9 ESTÁ PRESSIONADA?
	GOTO	$+4		; NÃO, ENTÃO SALTA 4 POSIÇÕES DE MEMÓRIA
	MOVLW	CARACTER_9	; SIM, ENTÃO MOVE O CARACTER 9 PARA W
	MOVWF	DEZENA		; MOVE O DADO PARA A VARIÁVEL DE MILHAR
	CALL	TOCA_BEEP	; CHAMA ROTINA PARA TOCAR O BEEP
		
	BTFSS	TECLA_C		; TECLA C ESTÁ PRESSIONADA?
	GOTO	$+4		; NÃO, ENTÃO SALTA 4 POSIÇÕES DE MEMÓRIA
	MOVLW	CARACTER_C	; SIM, ENTÃO MOVE O CARACTER C PARA W
	MOVWF	UNIDADE		; MOVE O DADO PARA A VARIÁVEL DE MILHAR
	CALL	TOCA_BEEP	; CHAMA ROTINA PARA TOCAR O BEEP
		
	BTFSS	TECLA_0		; TECLA 0 ESTÁ PRESSIONADA?
	GOTO	$+4		; NÃO, ENTÃO SALTA 4 POSIÇÕES DE MEMÓRIA
	MOVLW	CARACTER_0	; SIM, ENTÃO MOVE O CARACTER 0 PARA W
	MOVWF	UNIDADE		; MOVE O DADO PARA A VARIÁVEL DE MILHAR
	CALL	TOCA_BEEP	; CHAMA ROTINA PARA TOCAR O BEEP
		
	BTFSS	TECLA_E		; TECLA E ESTÁ PRESSIONADA?
	GOTO	$+4		; NÃO, ENTÃO SALTA 4 POSIÇÕES DE MEMÓRIA
	MOVLW	CARACTER_E	; SIM, ENTÃO MOVE O CARACTER E PARA W	
	MOVWF	UNIDADE		; MOVE O DADO PARA A VARIÁVEL DE MILHAR
	CALL	TOCA_BEEP	; CHAMA ROTINA PARA TOCAR O BEEP
			
	GOTO	LOOP		; SALTA PARA O LOOP PRINCIPAL
		
;*	*	*	*	*	*	*	*	*	*
;*		             FIM DO PROGRAMA				*
;*	*	*	*	*	*	*	*	*	*


	END			; FIM DO PROGRAMA


